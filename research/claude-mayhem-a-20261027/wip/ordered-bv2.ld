
PHDRS
{
  text PT_LOAD ;
  rodata PT_LOAD ;
  data PT_LOAD ;
  dynamic PT_DYNAMIC ;
}

SECTIONS
{
  . = SIZEOF_HEADERS;
  .text : {
    *mayhem_recovered.mayhem_recovered.a46a1b6815b9c4-cgu.0.rcgu.o(".text._ZN103_$LT$anchor_lang..accounts..interface..Interface$LT$T$GT$$u20$as$u20$anchor_lang..Accounts$LT$B$GT$$GT$12try_accounts17h0ea37c5f20a4154fE")
    *mayhem_recovered.mayhem_recovered.a46a1b6815b9c4-cgu.0.rcgu.o(".text._ZN106_$LT$curve_accounts..account_wrapper..AccountWrapper$LT$T$GT$$u20$as$u20$anchor_lang..AccountSerialize$GT$13try_serialize17hff7c9b7cf1e9b2f4E")
    *mayhem_recovered.mayhem_recovered.a46a1b6815b9c4-cgu.0.rcgu.o(".text._ZN97_$LT$mayhem_recovered..instructions..sell..SellCurve$u20$as$u20$anchor_lang..AccountSerialize$GT$13try_serialize17h460320f85ef93f7fE")
    *mayhem_recovered.mayhem_recovered.a46a1b6815b9c4-cgu.0.rcgu.o(".text.unlikely._ZN16mayhem_recovered15account_wrapper109_$LT$impl$u20$anchor_lang..AccountDeserialize$u20$for$u20$mayhem_recovered..instructions..sell..SellCurve$GT$25try_deserialize_unchecked17ha7b1a2e94ea8445cE")
    *mayhem_recovered.mayhem_recovered.a46a1b6815b9c4-cgu.0.rcgu.o(".text.unlikely._ZN108_$LT$curve_accounts..account_wrapper..AccountWrapper$LT$T$GT$$u20$as$u20$anchor_lang..AccountDeserialize$GT$25try_deserialize_unchecked17h858ede3bad01e083E")
    *mayhem_recovered.mayhem_recovered.a46a1b6815b9c4-cgu.0.rcgu.o(".text._ZN111_$LT$alloc..vec..Vec$LT$T$GT$$u20$as$u20$alloc..vec..spec_from_iter_nested..SpecFromIterNested$LT$T$C$I$GT$$GT$9from_iter17h17d167f4277c5f42E")
    *mayhem_recovered.mayhem_recovered.a46a1b6815b9c4-cgu.0.rcgu.o(".text._ZN118_$LT$anchor_lang..accounts..interface_account..InterfaceAccount$LT$T$GT$$u20$as$u20$anchor_lang..Accounts$LT$B$GT$$GT$12try_accounts17h073be56510a94682E")
    *mayhem_recovered.mayhem_recovered.a46a1b6815b9c4-cgu.0.rcgu.o(".text._ZN118_$LT$anchor_lang..accounts..interface_account..InterfaceAccount$LT$T$GT$$u20$as$u20$anchor_lang..Accounts$LT$B$GT$$GT$12try_accounts17h06a5d69938102232E")
    *mayhem_recovered.mayhem_recovered.a46a1b6815b9c4-cgu.0.rcgu.o(".text._ZN11anchor_lang5error5Error11with_values17hed9dc1f78600a28aE")
    *mayhem_recovered.mayhem_recovered.a46a1b6815b9c4-cgu.0.rcgu.o(".text._ZN11anchor_lang5error5Error11with_values17h42a68afc59120a22E")
    *mayhem_recovered.mayhem_recovered.a46a1b6815b9c4-cgu.0.rcgu.o(".text._ZN11anchor_lang5error5Error17with_account_name17h07c7e824cc61c2a9E")
    *mayhem_recovered.mayhem_recovered.a46a1b6815b9c4-cgu.0.rcgu.o(".text._ZN11anchor_lang5error5Error17with_account_name17h87aee6fd3f57cec0E")
    *mayhem_recovered.mayhem_recovered.a46a1b6815b9c4-cgu.0.rcgu.o(".text._ZN11anchor_lang8accounts17interface_account25InterfaceAccount$LT$T$GT$18try_from_unchecked17he80aa002f06a5aaeE")
    *mayhem_recovered.mayhem_recovered.a46a1b6815b9c4-cgu.0.rcgu.o(".text._ZN11anchor_lang8accounts17interface_account25InterfaceAccount$LT$T$GT$6reload17hc7a5a49c1b73401bE")
    *mayhem_recovered.mayhem_recovered.a46a1b6815b9c4-cgu.0.rcgu.o(".text._ZN11anchor_lang8accounts17interface_account25InterfaceAccount$LT$T$GT$8try_from17h63c79cd912b7da8aE")
    *mayhem_recovered.mayhem_recovered.a46a1b6815b9c4-cgu.0.rcgu.o(".text._ZN11anchor_lang8accounts5boxed87_$LT$impl$u20$anchor_lang..Accounts$LT$B$GT$$u20$for$u20$alloc..boxed..Box$LT$T$GT$$GT$12try_accounts17h74bdf5015c6ca5adE")
    *mayhem_recovered.mayhem_recovered.a46a1b6815b9c4-cgu.0.rcgu.o(".text._ZN11anchor_lang8accounts5boxed87_$LT$impl$u20$anchor_lang..Accounts$LT$B$GT$$u20$for$u20$alloc..boxed..Box$LT$T$GT$$GT$12try_accounts17h4652009b51d0cccfE")
    *mayhem_recovered.mayhem_recovered.a46a1b6815b9c4-cgu.0.rcgu.o(".text._ZN11anchor_lang8accounts5boxed87_$LT$impl$u20$anchor_lang..Accounts$LT$B$GT$$u20$for$u20$alloc..boxed..Box$LT$T$GT$$GT$12try_accounts17h42b80bf0ee1ab011E")
    *mayhem_recovered.mayhem_recovered.a46a1b6815b9c4-cgu.0.rcgu.o(".text._ZN11anchor_lang8accounts5boxed87_$LT$impl$u20$anchor_lang..Accounts$LT$B$GT$$u20$for$u20$alloc..boxed..Box$LT$T$GT$$GT$12try_accounts17h0359c463fb39cb1dE")
    *mayhem_recovered.mayhem_recovered.a46a1b6815b9c4-cgu.0.rcgu.o(".text._ZN11anchor_lang8accounts5boxed87_$LT$impl$u20$anchor_lang..Accounts$LT$B$GT$$u20$for$u20$alloc..boxed..Box$LT$T$GT$$GT$12try_accounts17h6cf8df7375860a9fE")
    *mayhem_recovered.mayhem_recovered.a46a1b6815b9c4-cgu.0.rcgu.o(".text._ZN11anchor_lang8accounts5boxed87_$LT$impl$u20$anchor_lang..Accounts$LT$B$GT$$u20$for$u20$alloc..boxed..Box$LT$T$GT$$GT$12try_accounts17h9ab5a86b260f3d97E")
    *mayhem_recovered.mayhem_recovered.a46a1b6815b9c4-cgu.0.rcgu.o(".text._ZN11anchor_lang8accounts7account16Account$LT$T$GT$18try_from_unchecked17h5712a1c568f12570E")
    *mayhem_recovered.mayhem_recovered.a46a1b6815b9c4-cgu.0.rcgu.o(".text._ZN11anchor_lang8accounts7account16Account$LT$T$GT$18try_from_unchecked17hb5ec73ab649350c0E")
    *mayhem_recovered.mayhem_recovered.a46a1b6815b9c4-cgu.0.rcgu.o(".text._ZN11anchor_lang8accounts7account16Account$LT$T$GT$18try_from_unchecked17h57c5b41d6bf2b488E")
    *mayhem_recovered.mayhem_recovered.a46a1b6815b9c4-cgu.0.rcgu.o(".text._ZN11anchor_lang8accounts7account16Account$LT$T$GT$24exit_with_expected_owner17h386c34bdb3a7a202E")
    *mayhem_recovered.mayhem_recovered.a46a1b6815b9c4-cgu.0.rcgu.o(".text._ZN11anchor_lang8accounts7account16Account$LT$T$GT$6reload17h685c41fdcde75d7dE")
    *mayhem_recovered.mayhem_recovered.a46a1b6815b9c4-cgu.0.rcgu.o(".text._ZN11anchor_lang8accounts7account16Account$LT$T$GT$8try_from17h988b37a18fc873d9E")
    *mayhem_recovered.mayhem_recovered.a46a1b6815b9c4-cgu.0.rcgu.o(".text._ZN11anchor_lang8accounts7account16Account$LT$T$GT$8try_from17hb96536e5fffdbdf1E")
    *mayhem_recovered.mayhem_recovered.a46a1b6815b9c4-cgu.0.rcgu.o(".text._ZN11anchor_lang8accounts7account16Account$LT$T$GT$8try_from17h11a2418947caee13E")
    *mayhem_recovered.mayhem_recovered.a46a1b6815b9c4-cgu.0.rcgu.o(".text._ZN11anchor_lang8accounts7account16Account$LT$T$GT$8try_from17h3c12bee69d2569abE")
    *mayhem_recovered.mayhem_recovered.a46a1b6815b9c4-cgu.0.rcgu.o(".text._ZN11anchor_lang8accounts7account16Account$LT$T$GT$8try_from17h7089caa171b5f968E")
    *mayhem_recovered.mayhem_recovered.a46a1b6815b9c4-cgu.0.rcgu.o(".text._ZN11anchor_lang8accounts7account16Account$LT$T$GT$8try_from17hdc96ca175f57db80E")
    *mayhem_recovered.mayhem_recovered.a46a1b6815b9c4-cgu.0.rcgu.o(".text._ZN11anchor_lang8accounts7account16Account$LT$T$GT$8try_from17hdb3a3e5babfa5b30E")
    *mayhem_recovered.mayhem_recovered.a46a1b6815b9c4-cgu.0.rcgu.o(".text._ZN139_$LT$anchor_lang..accounts..interface..Interface$LT$T$GT$$u20$as$u20$core..convert..TryFrom$LT$$RF$solana_account_info..AccountInfo$GT$$GT$8try_from17h2f4902745d93dddfE")
    *mayhem_recovered.mayhem_recovered.a46a1b6815b9c4-cgu.0.rcgu.o(".text._ZN42_$LT$$RF$T$u20$as$u20$core..fmt..Debug$GT$3fmt17h4ef3a7dfd563fe5eE")
    *mayhem_recovered.mayhem_recovered.a46a1b6815b9c4-cgu.0.rcgu.o(".text._ZN42_$LT$$RF$T$u20$as$u20$core..fmt..Debug$GT$3fmt17h053069c3bd142fceE")
    *mayhem_recovered.mayhem_recovered.a46a1b6815b9c4-cgu.0.rcgu.o(".text._ZN4core3fmt3num49_$LT$impl$u20$core..fmt..Debug$u20$for$u20$u8$GT$3fmt17habfbb78acd9b5468E")
    *mayhem_recovered.mayhem_recovered.a46a1b6815b9c4-cgu.0.rcgu.o(".text._ZN4core3fmt5Write9write_fmt17ha96b8c3696d69618E")
    *mayhem_recovered.mayhem_recovered.a46a1b6815b9c4-cgu.0.rcgu.o(".text._ZN4core3ptr42drop_in_place$LT$alloc..string..String$GT$17h78720740df0f2864E")
    *mayhem_recovered.mayhem_recovered.a46a1b6815b9c4-cgu.0.rcgu.o(".text._ZN4core3ptr53drop_in_place$LT$solana_account_info..AccountInfo$GT$17h8f8dd4e9481468b2E")
    *mayhem_recovered.mayhem_recovered.a46a1b6815b9c4-cgu.0.rcgu.o(".text._ZN4core3ptr74drop_in_place$LT$$u5b$solana_account_info..AccountInfo$u3b$$u20$1$u5d$$GT$17h515bc27f1771c4f8E")
    *mayhem_recovered.mayhem_recovered.a46a1b6815b9c4-cgu.0.rcgu.o(".text._ZN4core3ptr76drop_in_place$LT$alloc..vec..Vec$LT$solana_account_info..AccountInfo$GT$$GT$17h4043324bebc31465E")
    *mayhem_recovered.mayhem_recovered.a46a1b6815b9c4-cgu.0.rcgu.o(".text._ZN4core4hash11BuildHasher8hash_one17h659cd02ed53a3532E")
    *mayhem_recovered.mayhem_recovered.a46a1b6815b9c4-cgu.0.rcgu.o(".text._ZN52_$LT$bool$u20$as$u20$borsh..de..BorshDeserialize$GT$18deserialize_reader17h98a568243b723ea1E")
    *mayhem_recovered.mayhem_recovered.a46a1b6815b9c4-cgu.0.rcgu.o(".text._ZN53_$LT$core..fmt..Error$u20$as$u20$core..fmt..Debug$GT$3fmt17haaa5bdc6ce3ebfafE")
    *mayhem_recovered.mayhem_recovered.a46a1b6815b9c4-cgu.0.rcgu.o(".text._ZN58_$LT$alloc..string..String$u20$as$u20$core..fmt..Write$GT$10write_char17h6537f18e3aa683b6E")
    *mayhem_recovered.mayhem_recovered.a46a1b6815b9c4-cgu.0.rcgu.o(".text._ZN58_$LT$alloc..string..String$u20$as$u20$core..fmt..Write$GT$9write_str17hca2d36081997e77fE")
    *mayhem_recovered.mayhem_recovered.a46a1b6815b9c4-cgu.0.rcgu.o(".text.unlikely._ZN5alloc7raw_vec11finish_grow17hd4247465e9630a1aE")
    *mayhem_recovered.mayhem_recovered.a46a1b6815b9c4-cgu.0.rcgu.o(".text.unlikely._ZN5alloc7raw_vec20RawVecInner$LT$A$GT$7reserve21do_reserve_and_handle17hc37e630c686aa0c1E")
    *mayhem_recovered.mayhem_recovered.a46a1b6815b9c4-cgu.0.rcgu.o(".text._ZN70_$LT$core..num..error..TryFromIntError$u20$as$u20$core..fmt..Debug$GT$3fmt17hac919583bbb90a47E")
    *mayhem_recovered.mayhem_recovered.a46a1b6815b9c4-cgu.0.rcgu.o(".text._ZN71_$LT$solana_account_info..AccountInfo$u20$as$u20$core..clone..Clone$GT$5clone17hd4841c21abb7ce01E")
    *mayhem_recovered.mayhem_recovered.a46a1b6815b9c4-cgu.0.rcgu.o(".text._ZN71_$LT$solana_address..Address$u20$as$u20$borsh..de..BorshDeserialize$GT$18deserialize_reader17h84ed474a14d1b911E")
    *mayhem_recovered.mayhem_recovered.a46a1b6815b9c4-cgu.0.rcgu.o(".text._ZN71_$LT$solana_program_error..ProgramError$u20$as$u20$core..fmt..Debug$GT$3fmt17h6c1b6a595146bf75E")
    *mayhem_recovered.mayhem_recovered.a46a1b6815b9c4-cgu.0.rcgu.o(".text._ZN77_$LT$core..option..Option$LT$T$GT$$u20$as$u20$borsh..de..BorshDeserialize$GT$18deserialize_reader17ha6edc0855457841dE")
    *mayhem_recovered.mayhem_recovered.a46a1b6815b9c4-cgu.0.rcgu.o(".text._ZN77_$LT$core..option..Option$LT$T$GT$$u20$as$u20$borsh..de..BorshDeserialize$GT$18deserialize_reader17hea184265a548c678E")
    *mayhem_recovered.mayhem_recovered.a46a1b6815b9c4-cgu.0.rcgu.o(".text._ZN88_$LT$anchor_lang..accounts..signer..Signer$u20$as$u20$anchor_lang..Accounts$LT$B$GT$$GT$12try_accounts17h04be77df34de654eE")
    *mayhem_recovered.mayhem_recovered.a46a1b6815b9c4-cgu.0.rcgu.o(".text._ZN99_$LT$anchor_lang..accounts..account..Account$LT$T$GT$$u20$as$u20$anchor_lang..Accounts$LT$B$GT$$GT$12try_accounts17h34762a687b4a4036E")
    *mayhem_recovered.mayhem_recovered.a46a1b6815b9c4-cgu.0.rcgu.o(".text._ZN99_$LT$anchor_lang..accounts..account..Account$LT$T$GT$$u20$as$u20$anchor_lang..Accounts$LT$B$GT$$GT$12try_accounts17h7ebb3c434091d19fE")
    *mayhem_recovered.mayhem_recovered.a46a1b6815b9c4-cgu.0.rcgu.o(".text._ZN99_$LT$anchor_lang..accounts..account..Account$LT$T$GT$$u20$as$u20$anchor_lang..Accounts$LT$B$GT$$GT$12try_accounts17h59668b78ff8616b8E")
    *mayhem_recovered.mayhem_recovered.a46a1b6815b9c4-cgu.0.rcgu.o(".text._ZN99_$LT$anchor_lang..accounts..account..Account$LT$T$GT$$u20$as$u20$anchor_lang..Accounts$LT$B$GT$$GT$12try_accounts17h242aff52b3af9bdaE")
    *mayhem_recovered.mayhem_recovered.a46a1b6815b9c4-cgu.0.rcgu.o(".text._ZN99_$LT$anchor_lang..accounts..account..Account$LT$T$GT$$u20$as$u20$anchor_lang..Accounts$LT$B$GT$$GT$12try_accounts17h0aed640bd8ac8bf9E")
    *mayhem_recovered.mayhem_recovered.a46a1b6815b9c4-cgu.0.rcgu.o(".text._ZN99_$LT$anchor_lang..accounts..account..Account$LT$T$GT$$u20$as$u20$anchor_lang..Accounts$LT$B$GT$$GT$12try_accounts17h142f9252ea2782b0E")
    *mayhem_recovered.mayhem_recovered.a46a1b6815b9c4-cgu.0.rcgu.o(".text._ZN99_$LT$anchor_lang..accounts..program..Program$LT$T$GT$$u20$as$u20$anchor_lang..Accounts$LT$B$GT$$GT$12try_accounts17h01b09f805eb34597E")
    *mayhem_recovered.mayhem_recovered.a46a1b6815b9c4-cgu.0.rcgu.o(".text._ZN99_$LT$anchor_lang..accounts..program..Program$LT$T$GT$$u20$as$u20$anchor_lang..Accounts$LT$B$GT$$GT$12try_accounts17h04f9d34656f184fbE")
    *mayhem_recovered.mayhem_recovered.a46a1b6815b9c4-cgu.0.rcgu.o(".text._ZN99_$LT$anchor_lang..accounts..program..Program$LT$T$GT$$u20$as$u20$anchor_lang..Accounts$LT$B$GT$$GT$12try_accounts17h69e035edd9009ecbE")
    *mayhem_recovered.mayhem_recovered.a46a1b6815b9c4-cgu.0.rcgu.o(".text._ZN99_$LT$anchor_lang..accounts..program..Program$LT$T$GT$$u20$as$u20$anchor_lang..Accounts$LT$B$GT$$GT$12try_accounts17h52c6c7e6b4003ae1E")
    *mayhem_recovered.mayhem_recovered.a46a1b6815b9c4-cgu.0.rcgu.o(".text._ZN9hashbrown3map28HashMap$LT$K$C$V$C$S$C$A$GT$6insert17h39754d8c3e3d0876E")
    *mayhem_recovered.mayhem_recovered.a46a1b6815b9c4-cgu.0.rcgu.o(".text.unlikely._ZN9hashbrown3raw21RawTable$LT$T$C$A$GT$14reserve_rehash17h041fd860a005784fE")
    *mayhem_recovered.mayhem_recovered.a46a1b6815b9c4-cgu.0.rcgu.o(".text._ZN16mayhem_recovered16mayhem_recovered14withdraw_admin17hc31d908dcf93adf9E")
    *mayhem_recovered.mayhem_recovered.a46a1b6815b9c4-cgu.0.rcgu.o(".text._ZN16mayhem_recovered16mayhem_recovered20withdraw_quote_admin17haf13a9a95de6c01eE")
    *mayhem_recovered.mayhem_recovered.a46a1b6815b9c4-cgu.0.rcgu.o(".text._ZN16mayhem_recovered16mayhem_recovered20update_global_params17h5df4e250e0706744E")
    *mayhem_recovered.mayhem_recovered.a46a1b6815b9c4-cgu.0.rcgu.o(".text._ZN16mayhem_recovered12instructions4burn7handler17h0844d232bc2dd7c9E")
    *mayhem_recovered.mayhem_recovered.a46a1b6815b9c4-cgu.0.rcgu.o(".text._ZN16mayhem_recovered12instructions14extend_account7handler17h33eefb7427ab53e0E")
    *mayhem_recovered.mayhem_recovered.a46a1b6815b9c4-cgu.0.rcgu.o(".text._ZN16mayhem_recovered12instructions14fee_recipients12FeeRecipient14validate_sweep17h5d3754765b856ec7E")
    *mayhem_recovered.mayhem_recovered.a46a1b6815b9c4-cgu.0.rcgu.o(".text._ZN16mayhem_recovered12instructions14fee_recipients10initialize17h21799ad39675f85fE")
    *mayhem_recovered.mayhem_recovered.a46a1b6815b9c4-cgu.0.rcgu.o(".text._ZN16mayhem_recovered16mayhem_recovered16sweep_fees_admin17h34ff26a06739862eE")
    *mayhem_recovered.mayhem_recovered.a46a1b6815b9c4-cgu.0.rcgu.o(".text._ZN16mayhem_recovered16mayhem_recovered10sweep_fees17h7173721454a79dabE")
    *mayhem_recovered.mayhem_recovered.a46a1b6815b9c4-cgu.0.rcgu.o(".text._ZN16mayhem_recovered12instructions13buy_pump_swap7handler17h97e3dc48e08cf522E")
    *mayhem_recovered.mayhem_recovered.a46a1b6815b9c4-cgu.0.rcgu.o(".text._ZN16mayhem_recovered12instructions18pump_amm_interface14buy_cpi_failed17hf115c8a2fed61cd9E")
    *mayhem_recovered.mayhem_recovered.a46a1b6815b9c4-cgu.0.rcgu.o(".text._ZN16mayhem_recovered12instructions14sell_pump_swap7handler17h10bab539394e4073E")
    *mayhem_recovered.mayhem_recovered.a46a1b6815b9c4-cgu.0.rcgu.o(".text._ZN16mayhem_recovered12instructions18pump_amm_interface15sell_cpi_failed17h4c21e32ea0923591E")
    *mayhem_recovered.mayhem_recovered.a46a1b6815b9c4-cgu.0.rcgu.o(".text._ZN16mayhem_recovered12instructions14pump_interface18legacy_buy_handler17h4271cb5a7dd8ea24E")
    *mayhem_recovered.mayhem_recovered.a46a1b6815b9c4-cgu.0.rcgu.o(".text._ZN16mayhem_recovered12instructions14pump_interface19legacy_sell_handler17h29b321c2bee510c1E")
    *mayhem_recovered.mayhem_recovered.a46a1b6815b9c4-cgu.0.rcgu.o(".text._ZN16mayhem_recovered12instructions17pump_interface_v214buy_v2_handler17hcd81db8377301bc5E")
    *mayhem_recovered.mayhem_recovered.a46a1b6815b9c4-cgu.0.rcgu.o(".text._ZN16mayhem_recovered12instructions17pump_interface_v215sell_v2_handler17h38d186980e52c827E")
    *mayhem_recovered.mayhem_recovered.a46a1b6815b9c4-cgu.0.rcgu.o(".text._ZN16mayhem_recovered5state12GlobalParams24validate_native_withdraw17h5e417d686e0739a5E")
    *mayhem_recovered.mayhem_recovered.a46a1b6815b9c4-cgu.0.rcgu.o(".text._ZN16mayhem_recovered5state12GlobalParams23validate_quote_withdraw17hdb5f184d4661347eE")
    *mayhem_recovered.mayhem_recovered.a46a1b6815b9c4-cgu.0.rcgu.o(".text._ZN16mayhem_recovered5state12GlobalParams12apply_update17hd8026b0ae003abf7E")
    *mayhem_recovered.mayhem_recovered.a46a1b6815b9c4-cgu.0.rcgu.o(".text._ZN16mayhem_recovered5state12GlobalParams12stop_trading17hce024f733e91cc68E")
    *mayhem_recovered.mayhem_recovered.a46a1b6815b9c4-cgu.0.rcgu.o(".text._ZN16mayhem_recovered5state12GlobalParams14resume_trading17hd434681034e6729cE")
    *mayhem_recovered.mayhem_recovered.a46a1b6815b9c4-cgu.0.rcgu.o(".text._ZN16mayhem_recovered5state14record_amm_buy17h76d7d3a45c1308e5E")
    *mayhem_recovered.mayhem_recovered.a46a1b6815b9c4-cgu.0.rcgu.o(".text._ZN16mayhem_recovered5state11record_sell17hbce562d21d034cefE")
    *mayhem_recovered.mayhem_recovered.a46a1b6815b9c4-cgu.0.rcgu.o(".text._ZN16mayhem_recovered5state9buy_quote17ha958525ca84b6400E")
    *mayhem_recovered.mayhem_recovered.a46a1b6815b9c4-cgu.0.rcgu.o(".text._ZN16mayhem_recovered5state10sell_quote17h9adcdcf03af72a06E")
    *mayhem_recovered.mayhem_recovered.a46a1b6815b9c4-cgu.0.rcgu.o(".text._ZN16mayhem_recovered5state11MayhemState14validate_trade17h7ef62c6ace2d7beaE")
    *mayhem_recovered.mayhem_recovered.a46a1b6815b9c4-cgu.0.rcgu.o(".text._ZN16mayhem_recovered5state11MayhemState14validate_quote17h7fc3714704fdb53bE")
    *mayhem_recovered.mayhem_recovered.a46a1b6815b9c4-cgu.0.rcgu.o(".text._ZN16mayhem_recovered11MayhemError4name17ha3ee754857b7b9caE")
    *mayhem_recovered.mayhem_recovered.a46a1b6815b9c4-cgu.0.rcgu.o(".text._ZN68_$LT$mayhem_recovered..MayhemError$u20$as$u20$core..fmt..Display$GT$3fmt17hd2424290dfb80f8cE")
    *mayhem_recovered.mayhem_recovered.a46a1b6815b9c4-cgu.0.rcgu.o(".text._ZN66_$LT$mayhem_recovered..MayhemError$u20$as$u20$core..fmt..Debug$GT$3fmt17h68b586be249ea759E")
    *mayhem_recovered.mayhem_recovered.a46a1b6815b9c4-cgu.0.rcgu.o(".text._ZN177_$LT$mayhem_recovered..instructions..admin..InitializeGlobalParams$u20$as$u20$anchor_lang..Accounts$LT$mayhem_recovered..instructions..admin..InitializeGlobalParamsBumps$GT$$GT$12try_accounts17h95ab3fcc943da380E")
    *mayhem_recovered.mayhem_recovered.a46a1b6815b9c4-cgu.0.rcgu.o(".text._ZN177_$LT$mayhem_recovered..instructions..admin..InitializeGlobalParams$u20$as$u20$anchor_lang..Accounts$LT$mayhem_recovered..instructions..admin..InitializeGlobalParamsBumps$GT$$GT$12try_accounts28_$u7b$$u7b$closure$u7d$$u7d$17hb0f97dc002fea4e1E")
    *mayhem_recovered.mayhem_recovered.a46a1b6815b9c4-cgu.0.rcgu.o(".text._ZN107_$LT$mayhem_recovered..instructions..admin..InitializeGlobalParams$u20$as$u20$anchor_lang..AccountsExit$GT$4exit17hf00e057fbac8a6aeE")
    *mayhem_recovered.mayhem_recovered.a46a1b6815b9c4-cgu.0.rcgu.o(".text._ZN101_$LT$mayhem_recovered..Admin$u20$as$u20$anchor_lang..Accounts$LT$mayhem_recovered..AdminBumps$GT$$GT$12try_accounts17hf532ae758be0ed8eE")
    *mayhem_recovered.mayhem_recovered.a46a1b6815b9c4-cgu.0.rcgu.o(".text._ZN69_$LT$mayhem_recovered..Admin$u20$as$u20$anchor_lang..AccountsExit$GT$4exit17h62e3b31d76b40ca9E")
    *mayhem_recovered.mayhem_recovered.a46a1b6815b9c4-cgu.0.rcgu.o(".text._ZN117_$LT$mayhem_recovered..WithdrawAdmin$u20$as$u20$anchor_lang..Accounts$LT$mayhem_recovered..WithdrawAdminBumps$GT$$GT$12try_accounts17h169ae7cce1700b3dE")
    *mayhem_recovered.mayhem_recovered.a46a1b6815b9c4-cgu.0.rcgu.o(".text._ZN77_$LT$mayhem_recovered..WithdrawAdmin$u20$as$u20$anchor_lang..AccountsExit$GT$4exit17h230c6dd357637c11E")
    *mayhem_recovered.mayhem_recovered.a46a1b6815b9c4-cgu.0.rcgu.o(".text._ZN127_$LT$mayhem_recovered..WithdrawQuoteAdmin$u20$as$u20$anchor_lang..Accounts$LT$mayhem_recovered..WithdrawQuoteAdminBumps$GT$$GT$12try_accounts17h0116d937b52171a1E")
    *mayhem_recovered.mayhem_recovered.a46a1b6815b9c4-cgu.0.rcgu.o(".text._ZN127_$LT$mayhem_recovered..WithdrawQuoteAdmin$u20$as$u20$anchor_lang..Accounts$LT$mayhem_recovered..WithdrawQuoteAdminBumps$GT$$GT$12try_accounts28_$u7b$$u7b$closure$u7d$$u7d$17h8b03b3cfae6dfb5aE")
    *mayhem_recovered.mayhem_recovered.a46a1b6815b9c4-cgu.0.rcgu.o(".text._ZN82_$LT$mayhem_recovered..WithdrawQuoteAdmin$u20$as$u20$anchor_lang..AccountsExit$GT$4exit17hc3559de8efb27eadE")
    *mayhem_recovered.mayhem_recovered.a46a1b6815b9c4-cgu.0.rcgu.o(".text._ZN151_$LT$mayhem_recovered..instructions..burn..BurnTokens$u20$as$u20$anchor_lang..Accounts$LT$mayhem_recovered..instructions..burn..BurnTokensBumps$GT$$GT$12try_accounts17h7fb8ffb8031bc386E")
    *mayhem_recovered.mayhem_recovered.a46a1b6815b9c4-cgu.0.rcgu.o(".text._ZN94_$LT$mayhem_recovered..instructions..burn..BurnTokens$u20$as$u20$anchor_lang..AccountsExit$GT$4exit17h9f80a2b00c779641E")
    *mayhem_recovered.mayhem_recovered.a46a1b6815b9c4-cgu.0.rcgu.o(".text._ZN117_$LT$mayhem_recovered..ExtendAccount$u20$as$u20$anchor_lang..Accounts$LT$mayhem_recovered..ExtendAccountBumps$GT$$GT$12try_accounts17h6c58deb4c33a58cdE")
    *mayhem_recovered.mayhem_recovered.a46a1b6815b9c4-cgu.0.rcgu.o(".text._ZN75_$LT$mayhem_recovered..ExtendAccountEvent$u20$as$u20$anchor_lang..Event$GT$4data17h71b715f120a3b965E")
    *mayhem_recovered.mayhem_recovered.a46a1b6815b9c4-cgu.0.rcgu.o(".text._ZN110_$LT$mayhem_recovered..instructions..fee_recipients..FeeRecipient$u20$as$u20$anchor_lang..AccountSerialize$GT$13try_serialize17h39d3a15d1dacd801E")
    *mayhem_recovered.mayhem_recovered.a46a1b6815b9c4-cgu.0.rcgu.o(".text._ZN112_$LT$mayhem_recovered..instructions..fee_recipients..FeeRecipient$u20$as$u20$anchor_lang..AccountDeserialize$GT$15try_deserialize17hff064fbab9d93d2dE")
    *mayhem_recovered.mayhem_recovered.a46a1b6815b9c4-cgu.0.rcgu.o(".text._ZN112_$LT$mayhem_recovered..instructions..fee_recipients..FeeRecipient$u20$as$u20$anchor_lang..AccountDeserialize$GT$25try_deserialize_unchecked17h3830ab695dba5afbE")
    *mayhem_recovered.mayhem_recovered.a46a1b6815b9c4-cgu.0.rcgu.o(".text._ZN195_$LT$mayhem_recovered..instructions..fee_recipients..InitializeFeeRecipient$u20$as$u20$anchor_lang..Accounts$LT$mayhem_recovered..instructions..fee_recipients..InitializeFeeRecipientBumps$GT$$GT$12try_accounts17h017816dad12fa743E")
    *mayhem_recovered.mayhem_recovered.a46a1b6815b9c4-cgu.0.rcgu.o(".text._ZN195_$LT$mayhem_recovered..instructions..fee_recipients..InitializeFeeRecipient$u20$as$u20$anchor_lang..Accounts$LT$mayhem_recovered..instructions..fee_recipients..InitializeFeeRecipientBumps$GT$$GT$12try_accounts28_$u7b$$u7b$closure$u7d$$u7d$17h74a7bd8897410e6fE")
    *mayhem_recovered.mayhem_recovered.a46a1b6815b9c4-cgu.0.rcgu.o(".text._ZN195_$LT$mayhem_recovered..instructions..fee_recipients..InitializeFeeRecipient$u20$as$u20$anchor_lang..Accounts$LT$mayhem_recovered..instructions..fee_recipients..InitializeFeeRecipientBumps$GT$$GT$12try_accounts28_$u7b$$u7b$closure$u7d$$u7d$17h358a6751f23a4cccE")
    *mayhem_recovered.mayhem_recovered.a46a1b6815b9c4-cgu.0.rcgu.o(".text._ZN116_$LT$mayhem_recovered..instructions..fee_recipients..InitializeFeeRecipient$u20$as$u20$anchor_lang..AccountsExit$GT$4exit17h751aca43356cb07bE")
    *mayhem_recovered.mayhem_recovered.a46a1b6815b9c4-cgu.0.rcgu.o(".text._ZN109_$LT$mayhem_recovered..SweepFees$u20$as$u20$anchor_lang..Accounts$LT$mayhem_recovered..SweepFeesBumps$GT$$GT$12try_accounts17ha320625b4beacd2cE")
    *mayhem_recovered.mayhem_recovered.a46a1b6815b9c4-cgu.0.rcgu.o(".text._ZN73_$LT$mayhem_recovered..SweepFees$u20$as$u20$anchor_lang..AccountsExit$GT$4exit17h7a11e1aa251fd474E")
    *mayhem_recovered.mayhem_recovered.a46a1b6815b9c4-cgu.0.rcgu.o(".text._ZN119_$LT$mayhem_recovered..SweepFeesAdmin$u20$as$u20$anchor_lang..Accounts$LT$mayhem_recovered..SweepFeesAdminBumps$GT$$GT$12try_accounts17he4d62c3bfac05df4E")
    *mayhem_recovered.mayhem_recovered.a46a1b6815b9c4-cgu.0.rcgu.o(".text._ZN78_$LT$mayhem_recovered..SweepFeesAdmin$u20$as$u20$anchor_lang..AccountsExit$GT$4exit17h5bff41c5e9c88166E")
    *mayhem_recovered.mayhem_recovered.a46a1b6815b9c4-cgu.0.rcgu.o(".text._ZN171_$LT$mayhem_recovered..instructions..buy_pump_swap..BuyPumpSwap$u20$as$u20$anchor_lang..Accounts$LT$mayhem_recovered..instructions..buy_pump_swap..BuyPumpSwapBumps$GT$$GT$12try_accounts17h7fc4be5ae531b1e7E")
    *mayhem_recovered.mayhem_recovered.a46a1b6815b9c4-cgu.0.rcgu.o(".text._ZN171_$LT$mayhem_recovered..instructions..buy_pump_swap..BuyPumpSwap$u20$as$u20$anchor_lang..Accounts$LT$mayhem_recovered..instructions..buy_pump_swap..BuyPumpSwapBumps$GT$$GT$12try_accounts28_$u7b$$u7b$closure$u7d$$u7d$17h27bec029539bd33eE")
    *mayhem_recovered.mayhem_recovered.a46a1b6815b9c4-cgu.0.rcgu.o(".text._ZN104_$LT$mayhem_recovered..instructions..buy_pump_swap..BuyPumpSwap$u20$as$u20$anchor_lang..AccountsExit$GT$4exit17hf378dfed51655adeE")
    *mayhem_recovered.mayhem_recovered.a46a1b6815b9c4-cgu.0.rcgu.o(".text._ZN175_$LT$mayhem_recovered..instructions..sell_pump_swap..SellPumpSwap$u20$as$u20$anchor_lang..Accounts$LT$mayhem_recovered..instructions..sell_pump_swap..SellPumpSwapBumps$GT$$GT$12try_accounts17h2c1679e0e8c06424E")
    *mayhem_recovered.mayhem_recovered.a46a1b6815b9c4-cgu.0.rcgu.o(".text._ZN106_$LT$mayhem_recovered..instructions..sell_pump_swap..SellPumpSwap$u20$as$u20$anchor_lang..AccountsExit$GT$4exit17hc7d58b52d23d84e7E")
    *mayhem_recovered.mayhem_recovered.a46a1b6815b9c4-cgu.0.rcgu.o(".text._ZN147_$LT$mayhem_recovered..instructions..buy..LegacyBuy$u20$as$u20$anchor_lang..Accounts$LT$mayhem_recovered..instructions..buy..LegacyBuyBumps$GT$$GT$12try_accounts17h0b2ee5b6256381f9E")
    *mayhem_recovered.mayhem_recovered.a46a1b6815b9c4-cgu.0.rcgu.o(".text._ZN92_$LT$mayhem_recovered..instructions..buy..LegacyBuy$u20$as$u20$anchor_lang..AccountsExit$GT$4exit17h1c76c59cd5644661E")
    *mayhem_recovered.mayhem_recovered.a46a1b6815b9c4-cgu.0.rcgu.o(".text._ZN151_$LT$mayhem_recovered..instructions..sell..LegacySell$u20$as$u20$anchor_lang..Accounts$LT$mayhem_recovered..instructions..sell..LegacySellBumps$GT$$GT$12try_accounts17hebeeef7931303a8cE")
    *mayhem_recovered.mayhem_recovered.a46a1b6815b9c4-cgu.0.rcgu.o(".text._ZN94_$LT$mayhem_recovered..instructions..sell..LegacySell$u20$as$u20$anchor_lang..AccountsExit$GT$4exit17h89d04297a661d05dE")
    *mayhem_recovered.mayhem_recovered.a46a1b6815b9c4-cgu.0.rcgu.o(".text._ZN96_$LT$mayhem_recovered..instructions..pump_interface..SellEvent$u20$as$u20$anchor_lang..Event$GT$4data17h82f54d794248eedaE")
    *mayhem_recovered.mayhem_recovered.a46a1b6815b9c4-cgu.0.rcgu.o(".text._ZN145_$LT$mayhem_recovered..instructions..buy_v2..BuyV2$u20$as$u20$anchor_lang..Accounts$LT$mayhem_recovered..instructions..buy_v2..BuyV2Bumps$GT$$GT$12try_accounts17h1a923c5dcf2e2f05E")
    *mayhem_recovered.mayhem_recovered.a46a1b6815b9c4-cgu.0.rcgu.o(".text._ZN91_$LT$mayhem_recovered..instructions..buy_v2..BuyV2$u20$as$u20$anchor_lang..AccountsExit$GT$4exit17h08b7dfc060fa4392E")
    *mayhem_recovered.mayhem_recovered.a46a1b6815b9c4-cgu.0.rcgu.o(".text._ZN149_$LT$mayhem_recovered..instructions..sell_v2..SellV2$u20$as$u20$anchor_lang..Accounts$LT$mayhem_recovered..instructions..sell_v2..SellV2Bumps$GT$$GT$12try_accounts17h1a4f526e1fc0d8c8E")
    *mayhem_recovered.mayhem_recovered.a46a1b6815b9c4-cgu.0.rcgu.o(".text._ZN93_$LT$mayhem_recovered..instructions..sell_v2..SellV2$u20$as$u20$anchor_lang..AccountsExit$GT$4exit17h4186b883fa0ebcaeE")
    *mayhem_recovered.mayhem_recovered.a46a1b6815b9c4-cgu.0.rcgu.o(".text._ZN87_$LT$mayhem_recovered..state..GlobalParams$u20$as$u20$anchor_lang..AccountSerialize$GT$13try_serialize17h6d69b537c6eec0a3E")
    *mayhem_recovered.mayhem_recovered.a46a1b6815b9c4-cgu.0.rcgu.o(".text._ZN89_$LT$mayhem_recovered..state..GlobalParams$u20$as$u20$anchor_lang..AccountDeserialize$GT$15try_deserialize17h53645fdc1521954bE")
    *mayhem_recovered.mayhem_recovered.a46a1b6815b9c4-cgu.0.rcgu.o(".text._ZN89_$LT$mayhem_recovered..state..GlobalParams$u20$as$u20$anchor_lang..AccountDeserialize$GT$25try_deserialize_unchecked17h956099a7b62141d7E")
    *mayhem_recovered.mayhem_recovered.a46a1b6815b9c4-cgu.0.rcgu.o(".text._ZN85_$LT$mayhem_recovered..state..MayhemStatus$u20$as$u20$borsh..de..BorshDeserialize$GT$18deserialize_reader17h9197ef94e3049243E")
    *mayhem_recovered.mayhem_recovered.a46a1b6815b9c4-cgu.0.rcgu.o(".text._ZN86_$LT$mayhem_recovered..state..MayhemState$u20$as$u20$anchor_lang..AccountSerialize$GT$13try_serialize17h70d67356b687ab53E")
    *mayhem_recovered.mayhem_recovered.a46a1b6815b9c4-cgu.0.rcgu.o(".text._ZN88_$LT$mayhem_recovered..state..MayhemState$u20$as$u20$anchor_lang..AccountDeserialize$GT$15try_deserialize17h47ddf2c99a33e46fE")
    *mayhem_recovered.mayhem_recovered.a46a1b6815b9c4-cgu.0.rcgu.o(".text._ZN88_$LT$mayhem_recovered..state..MayhemState$u20$as$u20$anchor_lang..AccountDeserialize$GT$25try_deserialize_unchecked17h1cd72a49fdd44c22E")
    *mayhem_recovered.mayhem_recovered.a46a1b6815b9c4-cgu.0.rcgu.o(".text._ZN147_$LT$mayhem_recovered..state..InitializeMayhemState$u20$as$u20$anchor_lang..Accounts$LT$mayhem_recovered..state..InitializeMayhemStateBumps$GT$$GT$12try_accounts17h05ad09b75c833df5E")
    *mayhem_recovered.mayhem_recovered.a46a1b6815b9c4-cgu.0.rcgu.o(".text._ZN147_$LT$mayhem_recovered..state..InitializeMayhemState$u20$as$u20$anchor_lang..Accounts$LT$mayhem_recovered..state..InitializeMayhemStateBumps$GT$$GT$12try_accounts28_$u7b$$u7b$closure$u7d$$u7d$17h178dd27620646feeE")
    *mayhem_recovered.mayhem_recovered.a46a1b6815b9c4-cgu.0.rcgu.o(".text._ZN147_$LT$mayhem_recovered..state..InitializeMayhemState$u20$as$u20$anchor_lang..Accounts$LT$mayhem_recovered..state..InitializeMayhemStateBumps$GT$$GT$12try_accounts28_$u7b$$u7b$closure$u7d$$u7d$17h437676fbc72f39ddE")
    *mayhem_recovered.mayhem_recovered.a46a1b6815b9c4-cgu.0.rcgu.o(".text._ZN92_$LT$mayhem_recovered..state..InitializeMayhemState$u20$as$u20$anchor_lang..AccountsExit$GT$4exit17hfa65569be3f4bd0cE")
    *mayhem_recovered.mayhem_recovered.a46a1b6815b9c4-cgu.0.rcgu.o(".text._ZN80_$LT$mayhem_recovered..BondingCurve$u20$as$u20$anchor_lang..AccountSerialize$GT$13try_serialize17h0e255d8728f805cdE")
    *mayhem_recovered.mayhem_recovered.a46a1b6815b9c4-cgu.0.rcgu.o(".text._ZN82_$LT$mayhem_recovered..BondingCurve$u20$as$u20$anchor_lang..AccountDeserialize$GT$15try_deserialize17h614010ccd3065bceE")
    *mayhem_recovered.mayhem_recovered.a46a1b6815b9c4-cgu.0.rcgu.o(".text._ZN82_$LT$mayhem_recovered..BondingCurve$u20$as$u20$anchor_lang..AccountDeserialize$GT$25try_deserialize_unchecked17h91ca663293c2a2fbE")
    *mayhem_recovered.mayhem_recovered.a46a1b6815b9c4-cgu.0.rcgu.o(".text._ZN16mayhem_recovered4pump3cpi3buy17h7e8b7595707b5bd1E")
    *mayhem_recovered.mayhem_recovered.a46a1b6815b9c4-cgu.0.rcgu.o(".text._ZN16mayhem_recovered4pump3cpi4sell17hfaba089f6b375a48E")
    *mayhem_recovered.mayhem_recovered.a46a1b6815b9c4-cgu.0.rcgu.o(".text._ZN112_$LT$mayhem_recovered..pump..internal..__cpi_client_accounts_buy..Buy$u20$as$u20$anchor_lang..ToAccountMetas$GT$16to_account_metas17h274751a8e37abf14E")
    *mayhem_recovered.mayhem_recovered.a46a1b6815b9c4-cgu.0.rcgu.o(".text._ZN112_$LT$mayhem_recovered..pump..internal..__cpi_client_accounts_buy..Buy$u20$as$u20$anchor_lang..ToAccountInfos$GT$16to_account_infos17h15db7416671ad702E")
    *mayhem_recovered.mayhem_recovered.a46a1b6815b9c4-cgu.0.rcgu.o(".text._ZN114_$LT$mayhem_recovered..pump..internal..__cpi_client_accounts_sell..Sell$u20$as$u20$anchor_lang..ToAccountMetas$GT$16to_account_metas17hb65e8ed60a48c6f2E")
    *mayhem_recovered.mayhem_recovered.a46a1b6815b9c4-cgu.0.rcgu.o(".text._ZN114_$LT$mayhem_recovered..pump..internal..__cpi_client_accounts_sell..Sell$u20$as$u20$anchor_lang..ToAccountInfos$GT$16to_account_infos17hd2884db90d2977b0E")
    *mayhem_recovered.mayhem_recovered.a46a1b6815b9c4-cgu.0.rcgu.o(".text._ZN102_$LT$mayhem_recovered..pump_amm..accounts..GlobalConfig$u20$as$u20$anchor_lang..AccountDeserialize$GT$15try_deserialize17hca25af292f860de8E")
    *mayhem_recovered.mayhem_recovered.a46a1b6815b9c4-cgu.0.rcgu.o(".text._ZN102_$LT$mayhem_recovered..pump_amm..accounts..GlobalConfig$u20$as$u20$anchor_lang..AccountDeserialize$GT$25try_deserialize_unchecked17ha5fbff34531fadaeE")
    *mayhem_recovered.mayhem_recovered.a46a1b6815b9c4-cgu.0.rcgu.o(".text._ZN16mayhem_recovered7amm_cpi3cpi3buy17h270ee5106a7fef04E")
    *mayhem_recovered.mayhem_recovered.a46a1b6815b9c4-cgu.0.rcgu.o(".text._ZN16mayhem_recovered7amm_cpi3cpi4sell17h3ff8d6a29640c9bfE")
    *mayhem_recovered.mayhem_recovered.a46a1b6815b9c4-cgu.0.rcgu.o(".text._ZN115_$LT$mayhem_recovered..amm_cpi..internal..__cpi_client_accounts_buy..Buy$u20$as$u20$anchor_lang..ToAccountMetas$GT$16to_account_metas17hdcdadd82b87350aaE")
    *mayhem_recovered.mayhem_recovered.a46a1b6815b9c4-cgu.0.rcgu.o(".text._ZN115_$LT$mayhem_recovered..amm_cpi..internal..__cpi_client_accounts_buy..Buy$u20$as$u20$anchor_lang..ToAccountInfos$GT$16to_account_infos17he2ed77fe594f6045E")
    *mayhem_recovered.mayhem_recovered.a46a1b6815b9c4-cgu.0.rcgu.o(".text._ZN117_$LT$mayhem_recovered..amm_cpi..internal..__cpi_client_accounts_sell..Sell$u20$as$u20$anchor_lang..ToAccountMetas$GT$16to_account_metas17h57a002e99b35597cE")
    *mayhem_recovered.mayhem_recovered.a46a1b6815b9c4-cgu.0.rcgu.o(".text._ZN117_$LT$mayhem_recovered..amm_cpi..internal..__cpi_client_accounts_sell..Sell$u20$as$u20$anchor_lang..ToAccountInfos$GT$16to_account_infos17h7b41416bed9b46d1E")
    *mayhem_recovered.mayhem_recovered.a46a1b6815b9c4-cgu.0.rcgu.o(".text._ZN16mayhem_recovered5entry17h2fa541bf5d7acde6E")
    *mayhem_recovered.mayhem_recovered.a46a1b6815b9c4-cgu.0.rcgu.o(".text._ZN16mayhem_recovered9__private8__global24initialize_global_params17h32a414a032c4aa20E")
    *mayhem_recovered.mayhem_recovered.a46a1b6815b9c4-cgu.0.rcgu.o(".text._ZN16mayhem_recovered9__private8__global24initialize_fee_recipient17h093ed9a2556f2472E")
    *mayhem_recovered.mayhem_recovered.a46a1b6815b9c4-cgu.0.rcgu.o(".text._ZN16mayhem_recovered9__private8__global10sweep_fees17h4b9fb20a9829b7e8E")
    *mayhem_recovered.mayhem_recovered.a46a1b6815b9c4-cgu.0.rcgu.o(".text._ZN16mayhem_recovered9__private8__global16sweep_fees_admin17h750aa490cb4e66dbE")
    *mayhem_recovered.mayhem_recovered.a46a1b6815b9c4-cgu.0.rcgu.o(".text._ZN16mayhem_recovered9__private8__global24update_max_sol_per_sweep17hc7f3ed7f0be261adE")
    *mayhem_recovered.mayhem_recovered.a46a1b6815b9c4-cgu.0.rcgu.o(".text._ZN16mayhem_recovered9__private8__global27update_max_stable_per_sweep17h1382eab3232a9ad2E")
    *mayhem_recovered.mayhem_recovered.a46a1b6815b9c4-cgu.0.rcgu.o(".text._ZN16mayhem_recovered9__private8__global14withdraw_admin17ha71f21b31308aba4E")
    *mayhem_recovered.mayhem_recovered.a46a1b6815b9c4-cgu.0.rcgu.o(".text._ZN16mayhem_recovered9__private8__global20withdraw_quote_admin17h4c7653861e894cc8E")
    *mayhem_recovered.mayhem_recovered.a46a1b6815b9c4-cgu.0.rcgu.o(".text._ZN16mayhem_recovered9__private8__global13update_trader17h6a05404ecd0f359bE")
    *mayhem_recovered.mayhem_recovered.a46a1b6815b9c4-cgu.0.rcgu.o(".text._ZN16mayhem_recovered9__private8__global12update_admin17h4735c1ac91c2c761E")
    *mayhem_recovered.mayhem_recovered.a46a1b6815b9c4-cgu.0.rcgu.o(".text._ZN16mayhem_recovered9__private8__global11reset_state17h507193dadc3c3422E")
    *mayhem_recovered.mayhem_recovered.a46a1b6815b9c4-cgu.0.rcgu.o(".text._ZN16mayhem_recovered9__private8__global18reset_sol_deployed17h8161bceb5c9c2ba7E")
    *mayhem_recovered.mayhem_recovered.a46a1b6815b9c4-cgu.0.rcgu.o(".text._ZN16mayhem_recovered9__private8__global21reset_stable_deployed17h26139c35e17d6536E")
    *mayhem_recovered.mayhem_recovered.a46a1b6815b9c4-cgu.0.rcgu.o(".text._ZN16mayhem_recovered9__private8__global14resume_trading17h4d4c15d0d7dc9421E")
    *mayhem_recovered.mayhem_recovered.a46a1b6815b9c4-cgu.0.rcgu.o(".text._ZN16mayhem_recovered9__private8__global12stop_trading17h9093c76eb7b96b93E")
    *mayhem_recovered.mayhem_recovered.a46a1b6815b9c4-cgu.0.rcgu.o(".text._ZN16mayhem_recovered9__private8__global11burn_tokens17hb9962757161202c2E")
    *mayhem_recovered.mayhem_recovered.a46a1b6815b9c4-cgu.0.rcgu.o(".text._ZN16mayhem_recovered9__private8__global14extend_account17h338533c98a3fae5dE")
    *mayhem_recovered.mayhem_recovered.a46a1b6815b9c4-cgu.0.rcgu.o(".text._ZN16mayhem_recovered9__private8__global20update_global_params17h5e5aa6a10355f0b3E")
    *mayhem_recovered.mayhem_recovered.a46a1b6815b9c4-cgu.0.rcgu.o(".text._ZN16mayhem_recovered9__private8__global23initialize_mayhem_state17h5870af45d4a06e82E")
    *mayhem_recovered.mayhem_recovered.a46a1b6815b9c4-cgu.0.rcgu.o(".text._ZN16mayhem_recovered9__private8__global4sell17h60bcd670375fa6aaE")
    *mayhem_recovered.mayhem_recovered.a46a1b6815b9c4-cgu.0.rcgu.o(".text._ZN16mayhem_recovered9__private8__global3buy17hfaac4a67df917e30E")
    *mayhem_recovered.mayhem_recovered.a46a1b6815b9c4-cgu.0.rcgu.o(".text._ZN16mayhem_recovered9__private8__global7sell_v217h69c3045789f4438cE")
    *mayhem_recovered.mayhem_recovered.a46a1b6815b9c4-cgu.0.rcgu.o(".text._ZN16mayhem_recovered9__private8__global6buy_v217h8243d16ce630ac9fE")
    *mayhem_recovered.mayhem_recovered.a46a1b6815b9c4-cgu.0.rcgu.o(".text._ZN16mayhem_recovered9__private8__global14sell_pump_swap17hd8ac4448a95824e7E")
    *mayhem_recovered.mayhem_recovered.a46a1b6815b9c4-cgu.0.rcgu.o(".text._ZN16mayhem_recovered9__private8__global13buy_pump_swap17hce7bbd3695549df2E")
    *mayhem_recovered.mayhem_recovered.a46a1b6815b9c4-cgu.0.rcgu.o(".text._ZN16mayhem_recovered9__private8__events16__event_dispatch17h1c30711e1f861ed2E")
    *mayhem_recovered.mayhem_recovered.a46a1b6815b9c4-cgu.0.rcgu.o(".text._ZN16mayhem_recovered5state10initialize17hbe26f996e19007a1E")
    *mayhem_recovered.mayhem_recovered.a46a1b6815b9c4-cgu.0.rcgu.o(".text.entrypoint")
    *mayhem_recovered.mayhem_recovered.a46a1b6815b9c4-cgu.0.rcgu.o(".text._RNvCscR3e5J6VSLN_7___rustc12___rust_alloc")
    *mayhem_recovered.mayhem_recovered.a46a1b6815b9c4-cgu.0.rcgu.o(".text._RNvCscR3e5J6VSLN_7___rustc14___rust_dealloc")
    *mayhem_recovered.mayhem_recovered.a46a1b6815b9c4-cgu.0.rcgu.o(".text._RNvCscR3e5J6VSLN_7___rustc14___rust_realloc")
    *mayhem_recovered.mayhem_recovered.a46a1b6815b9c4-cgu.0.rcgu.o(".text._RNvCscR3e5J6VSLN_7___rustc19___rust_alloc_zeroed")
    *mayhem_recovered.mayhem_recovered.a46a1b6815b9c4-cgu.0.rcgu.o(".text.custom_panic")
    *mayhem_recovered.9ltie3gb78bh3dikfv8afzf6p.rcgu.o(".text._RNvCscR3e5J6VSLN_7___rustc26___rust_alloc_error_handler")
    *mayhem_recovered.9ltie3gb78bh3dikfv8afzf6p.rcgu.o(".text._RNvCscR3e5J6VSLN_7___rustc35___rust_no_alloc_shim_is_unstable_v2")
    *libcurve_accounts-a46b64d8dfd1b3b9.rlib:curve_accounts-a46b64d8dfd1b3b9.curve_accounts.8b398f178c92b1a1-cgu.0.rcgu.o(".text._ZN11anchor_lang5error5Error17with_account_name17h4433a32a053eed48E")
    *libcurve_accounts-a46b64d8dfd1b3b9.rlib:curve_accounts-a46b64d8dfd1b3b9.curve_accounts.8b398f178c92b1a1-cgu.0.rcgu.o(".text._ZN4core3fmt5Write9write_fmt17h204abd89abccb388E")
    *libcurve_accounts-a46b64d8dfd1b3b9.rlib:curve_accounts-a46b64d8dfd1b3b9.curve_accounts.8b398f178c92b1a1-cgu.0.rcgu.o(".text._ZN4core3ptr42drop_in_place$LT$alloc..string..String$GT$17h289c67f23bf72091E")
    *libcurve_accounts-a46b64d8dfd1b3b9.rlib:curve_accounts-a46b64d8dfd1b3b9.curve_accounts.8b398f178c92b1a1-cgu.0.rcgu.o(".text._ZN52_$LT$bool$u20$as$u20$borsh..de..BorshDeserialize$GT$18deserialize_reader17hde8e3cb89b627eadE")
    *libcurve_accounts-a46b64d8dfd1b3b9.rlib:curve_accounts-a46b64d8dfd1b3b9.curve_accounts.8b398f178c92b1a1-cgu.0.rcgu.o(".text._ZN53_$LT$core..fmt..Error$u20$as$u20$core..fmt..Debug$GT$3fmt17haaa5bdc6ce3ebfafE")
    *libcurve_accounts-a46b64d8dfd1b3b9.rlib:curve_accounts-a46b64d8dfd1b3b9.curve_accounts.8b398f178c92b1a1-cgu.0.rcgu.o(".text._ZN58_$LT$alloc..string..String$u20$as$u20$core..fmt..Write$GT$10write_char17h6537f18e3aa683b6E")
    *libcurve_accounts-a46b64d8dfd1b3b9.rlib:curve_accounts-a46b64d8dfd1b3b9.curve_accounts.8b398f178c92b1a1-cgu.0.rcgu.o(".text._ZN58_$LT$alloc..string..String$u20$as$u20$core..fmt..Write$GT$9write_str17hca2d36081997e77fE")
    *libcurve_accounts-a46b64d8dfd1b3b9.rlib:curve_accounts-a46b64d8dfd1b3b9.curve_accounts.8b398f178c92b1a1-cgu.0.rcgu.o(".text.unlikely._ZN5alloc7raw_vec11finish_grow17h728583255202ce8aE")
    *libcurve_accounts-a46b64d8dfd1b3b9.rlib:curve_accounts-a46b64d8dfd1b3b9.curve_accounts.8b398f178c92b1a1-cgu.0.rcgu.o(".text.unlikely._ZN5alloc7raw_vec20RawVecInner$LT$A$GT$7reserve21do_reserve_and_handle17h6332133866a83923E")
    *libcurve_accounts-a46b64d8dfd1b3b9.rlib:curve_accounts-a46b64d8dfd1b3b9.curve_accounts.8b398f178c92b1a1-cgu.0.rcgu.o(".text._ZN71_$LT$solana_address..Address$u20$as$u20$borsh..de..BorshDeserialize$GT$18deserialize_reader17hf2842f37125a1b8fE")
    *libcurve_accounts-a46b64d8dfd1b3b9.rlib:curve_accounts-a46b64d8dfd1b3b9.curve_accounts.8b398f178c92b1a1-cgu.0.rcgu.o(".text._ZN14curve_accounts21try_deserialize_curve17h46b57df79df2a81cE")
    *libcurve_accounts-a46b64d8dfd1b3b9.rlib:curve_accounts-a46b64d8dfd1b3b9.curve_accounts.8b398f178c92b1a1-cgu.0.rcgu.o(".text._ZN80_$LT$curve_accounts..BondingCurve$u20$as$u20$anchor_lang..AccountDeserialize$GT$25try_deserialize_unchecked17h07b876742f221706E")
    *libcurve_accounts-a46b64d8dfd1b3b9.rlib:curve_accounts-a46b64d8dfd1b3b9.curve_accounts.8b398f178c92b1a1-cgu.0.rcgu.o(".text._ZN14curve_accounts13cpi_interface16buy_v2_recovered17h90f9386494286f9eE")
    *libcurve_accounts-a46b64d8dfd1b3b9.rlib:curve_accounts-a46b64d8dfd1b3b9.curve_accounts.8b398f178c92b1a1-cgu.0.rcgu.o(".text._ZN14curve_accounts13cpi_interface4pump3cpi7sell_v217hc98b2ad3025bb278E")
    *libcurve_accounts-a46b64d8dfd1b3b9.rlib:curve_accounts-a46b64d8dfd1b3b9.curve_accounts.8b398f178c92b1a1-cgu.0.rcgu.o(".text._ZN130_$LT$curve_accounts..cpi_interface..pump..internal..__cpi_client_accounts_buy_v2..BuyV2$u20$as$u20$anchor_lang..ToAccountMetas$GT$16to_account_metas17h1a626ede55ade5e6E")
    *libcurve_accounts-a46b64d8dfd1b3b9.rlib:curve_accounts-a46b64d8dfd1b3b9.curve_accounts.8b398f178c92b1a1-cgu.0.rcgu.o(".text._ZN130_$LT$curve_accounts..cpi_interface..pump..internal..__cpi_client_accounts_buy_v2..BuyV2$u20$as$u20$anchor_lang..ToAccountInfos$GT$16to_account_infos17hbdb5d3ecffcb3b24E")
    *libcurve_accounts-a46b64d8dfd1b3b9.rlib:curve_accounts-a46b64d8dfd1b3b9.curve_accounts.8b398f178c92b1a1-cgu.0.rcgu.o(".text._ZN132_$LT$curve_accounts..cpi_interface..pump..internal..__cpi_client_accounts_sell_v2..SellV2$u20$as$u20$anchor_lang..ToAccountMetas$GT$16to_account_metas17hbd1c74b6de47c92fE")
    *libcurve_accounts-a46b64d8dfd1b3b9.rlib:curve_accounts-a46b64d8dfd1b3b9.curve_accounts.8b398f178c92b1a1-cgu.0.rcgu.o(".text._ZN132_$LT$curve_accounts..cpi_interface..pump..internal..__cpi_client_accounts_sell_v2..SellV2$u20$as$u20$anchor_lang..ToAccountInfos$GT$16to_account_infos17h1c143ef39b1b2c27E")
    *libcurve_accounts-a46b64d8dfd1b3b9.rlib:curve_accounts-a46b64d8dfd1b3b9.curve_accounts.8b398f178c92b1a1-cgu.0.rcgu.o(".text._ZN14curve_accounts20try_deserialize_pool17ha7e01d0e52e08480E")
    *libcurve_accounts-a46b64d8dfd1b3b9.rlib:curve_accounts-a46b64d8dfd1b3b9.curve_accounts.8b398f178c92b1a1-cgu.0.rcgu.o(".text._ZN72_$LT$curve_accounts..Pool$u20$as$u20$anchor_lang..AccountDeserialize$GT$25try_deserialize_unchecked17h2af08fd0006f907bE")
    *libcurve_accounts-a46b64d8dfd1b3b9.rlib:curve_accounts-a46b64d8dfd1b3b9.curve_accounts.8b398f178c92b1a1-cgu.0.rcgu.o(".text._ZN14curve_accounts13cpi_interface13BuyV2WireArgs9serialize17hcc348cc752d255c4E")
    *libanchor_spl-5efd9abd2467cb79.rlib:anchor_spl-5efd9abd2467cb79.anchor_spl.b486e8a5b399904a-cgu.0.rcgu.o(".text._ZN4core3ptr74drop_in_place$LT$$u5b$solana_account_info..AccountInfo$u3b$$u20$3$u5d$$GT$17h54bddc6c4481c224E")
    *libanchor_spl-5efd9abd2467cb79.rlib:anchor_spl-5efd9abd2467cb79.anchor_spl.b486e8a5b399904a-cgu.0.rcgu.o(".text._ZN4core3ptr74drop_in_place$LT$$u5b$solana_account_info..AccountInfo$u3b$$u20$6$u5d$$GT$17heac1c8430d4577feE")
    *libanchor_spl-5efd9abd2467cb79.rlib:anchor_spl-5efd9abd2467cb79.anchor_spl.b486e8a5b399904a-cgu.0.rcgu.o(".text._ZN10anchor_spl16associated_token6create17h8daf73164fb57777E")
    *libanchor_spl-5efd9abd2467cb79.rlib:anchor_spl-5efd9abd2467cb79.anchor_spl.b486e8a5b399904a-cgu.0.rcgu.o(".text._ZN10anchor_spl5token8transfer17hfb4c24390e056f08E")
    *libanchor_spl-5efd9abd2467cb79.rlib:anchor_spl-5efd9abd2467cb79.anchor_spl.b486e8a5b399904a-cgu.0.rcgu.o(".text._ZN10anchor_spl10token_20224burn17h1a95b450f8956952E")
    *libanchor_spl-5efd9abd2467cb79.rlib:anchor_spl-5efd9abd2467cb79.anchor_spl.b486e8a5b399904a-cgu.0.rcgu.o(".text._ZN10anchor_spl10token_202213close_account17h5d0171b0a311d112E")
    *libanchor_spl-5efd9abd2467cb79.rlib:anchor_spl-5efd9abd2467cb79.anchor_spl.b486e8a5b399904a-cgu.0.rcgu.o(".text._ZN10anchor_spl10token_202211sync_native17h42493ef1bf6c1035E")
    *libanchor_spl-5efd9abd2467cb79.rlib:anchor_spl-5efd9abd2467cb79.anchor_spl.b486e8a5b399904a-cgu.0.rcgu.o(".text._ZN93_$LT$anchor_spl..token_interface..TokenAccount$u20$as$u20$anchor_lang..AccountDeserialize$GT$25try_deserialize_unchecked17h0955d2e8f27acdcfE")
    *libanchor_spl-5efd9abd2467cb79.rlib:anchor_spl-5efd9abd2467cb79.anchor_spl.b486e8a5b399904a-cgu.0.rcgu.o(".text._ZN85_$LT$anchor_spl..token_interface..Mint$u20$as$u20$anchor_lang..AccountDeserialize$GT$25try_deserialize_unchecked17h53d62784d2772f3dE")
    *libspl_token_metadata_interface-a915c8b67427f38d.rlib:spl_token_metadata_interface-a915c8b67427f38d.spl_token_metadata_interface.2b455a22f7ec8994-cgu.0.rcgu.o(".text._ZN3std2io5error5Error3new17h79673499aaef8241E")
    *libspl_token_metadata_interface-a915c8b67427f38d.rlib:spl_token_metadata_interface-a915c8b67427f38d.spl_token_metadata_interface.2b455a22f7ec8994-cgu.0.rcgu.o(".text._ZN4core3ptr238drop_in_place$LT$alloc..boxed..convert..$LT$impl$u20$core..convert..From$LT$alloc..string..String$GT$$u20$for$u20$alloc..boxed..Box$LT$dyn$u20$core..error..Error$u2b$core..marker..Sync$u2b$core..marker..Send$GT$$GT$..from..StringError$GT$17h2dda4cc39ce47de4E")
    *libspl_token_metadata_interface-a915c8b67427f38d.rlib:spl_token_metadata_interface-a915c8b67427f38d.spl_token_metadata_interface.2b455a22f7ec8994-cgu.0.rcgu.o(".text._ZN4core5error5Error5cause17h0a37a7684a76b63aE")
    *libspl_token_metadata_interface-a915c8b67427f38d.rlib:spl_token_metadata_interface-a915c8b67427f38d.spl_token_metadata_interface.2b455a22f7ec8994-cgu.0.rcgu.o(".text._ZN4core5error5Error7provide17hf5f21b0539f0994eE")
    *libspl_token_metadata_interface-a915c8b67427f38d.rlib:spl_token_metadata_interface-a915c8b67427f38d.spl_token_metadata_interface.2b455a22f7ec8994-cgu.0.rcgu.o(".text._ZN4core5error5Error7type_id17ha0259a1763d0d052E")
    *libspl_token_2022_interface-6130131396c4c5c2.rlib:spl_token_2022_interface-6130131396c4c5c2.spl_token_2022_interface.912155aa0f4230e2-cgu.0.rcgu.o(".text.unlikely._ZN5alloc7raw_vec11finish_grow17h17edbe0f41563d73E")
    *libspl_token_2022_interface-6130131396c4c5c2.rlib:spl_token_2022_interface-6130131396c4c5c2.spl_token_2022_interface.912155aa0f4230e2-cgu.0.rcgu.o(".text.unlikely._ZN5alloc7raw_vec20RawVecInner$LT$A$GT$7reserve21do_reserve_and_handle17ha3ff6a31555fa195E")
    *libspl_token_2022_interface-6130131396c4c5c2.rlib:spl_token_2022_interface-6130131396c4c5c2.spl_token_2022_interface.912155aa0f4230e2-cgu.0.rcgu.o(".text._ZN24spl_token_2022_interface11instruction16TokenInstruction4pack17h859bf421d5f99844E")
    *libspl_token_2022_interface-6130131396c4c5c2.rlib:spl_token_2022_interface-6130131396c4c5c2.spl_token_2022_interface.912155aa0f4230e2-cgu.0.rcgu.o(".text._ZN24spl_token_2022_interface11instruction4burn17h73460c5203b69882E")
    *libspl_token_2022_interface-6130131396c4c5c2.rlib:spl_token_2022_interface-6130131396c4c5c2.spl_token_2022_interface.912155aa0f4230e2-cgu.0.rcgu.o(".text._ZN24spl_token_2022_interface11instruction13close_account17h53e230ad68fc3309E")
    *libspl_token_2022_interface-6130131396c4c5c2.rlib:spl_token_2022_interface-6130131396c4c5c2.spl_token_2022_interface.912155aa0f4230e2-cgu.0.rcgu.o(".text._ZN24spl_token_2022_interface11instruction11sync_native17h58d89e4122091583E")
    *libspl_token_2022_interface-6130131396c4c5c2.rlib:spl_token_2022_interface-6130131396c4c5c2.spl_token_2022_interface.912155aa0f4230e2-cgu.0.rcgu.o(".text._ZN83_$LT$spl_token_2022_interface..state..Mint$u20$as$u20$solana_program_pack..Pack$GT$17unpack_from_slice17h525a4a7c8f29f846E")
    *libspl_token_2022_interface-6130131396c4c5c2.rlib:spl_token_2022_interface-6130131396c4c5c2.spl_token_2022_interface.912155aa0f4230e2-cgu.0.rcgu.o(".text._ZN86_$LT$spl_token_2022_interface..state..Account$u20$as$u20$solana_program_pack..Pack$GT$17unpack_from_slice17he10047adaa527751E")
    *libspl_token_interface-a308f8dc9f1303bb.rlib:spl_token_interface-a308f8dc9f1303bb.spl_token_interface.6ff54d6023aeb658-cgu.0.rcgu.o(".text.unlikely._ZN5alloc7raw_vec11finish_grow17hf779e40fb7f813f5E")
    *libspl_token_interface-a308f8dc9f1303bb.rlib:spl_token_interface-a308f8dc9f1303bb.spl_token_interface.6ff54d6023aeb658-cgu.0.rcgu.o(".text._ZN5alloc7raw_vec19RawVec$LT$T$C$A$GT$8grow_one17h5debf5d68acb635dE")
    *libspl_token_interface-a308f8dc9f1303bb.rlib:spl_token_interface-a308f8dc9f1303bb.spl_token_interface.6ff54d6023aeb658-cgu.0.rcgu.o(".text.unlikely._ZN5alloc7raw_vec20RawVecInner$LT$A$GT$7reserve21do_reserve_and_handle17h108781aabe5c19a0E")
    *libspl_token_interface-a308f8dc9f1303bb.rlib:spl_token_interface-a308f8dc9f1303bb.spl_token_interface.6ff54d6023aeb658-cgu.0.rcgu.o(".text._ZN19spl_token_interface11instruction16TokenInstruction4pack17hdfef4310970ae834E")
    *libspl_token_interface-a308f8dc9f1303bb.rlib:spl_token_interface-a308f8dc9f1303bb.spl_token_interface.6ff54d6023aeb658-cgu.0.rcgu.o(".text._ZN19spl_token_interface11instruction8transfer17hd77cb71b301ecef0E")
    *libspl_associated_token_account_interface-68c0323a42ed5034.rlib:spl_associated_token_account_interface-68c0323a42ed5034.spl_associated_token_account_interface.3b2836850a8d22fe-cgu.0.rcgu.o(".text._ZN38spl_associated_token_account_interface7address44get_associated_token_address_with_program_id17h3313f478d3fef283E")
    *libspl_associated_token_account_interface-68c0323a42ed5034.rlib:spl_associated_token_account_interface-68c0323a42ed5034.spl_associated_token_account_interface.3b2836850a8d22fe-cgu.0.rcgu.o(".text._ZN38spl_associated_token_account_interface11instruction42build_associated_token_account_instruction17hab463d45c6db05dbE")
    *libspl_associated_token_account_interface-68c0323a42ed5034.rlib:spl_associated_token_account_interface-68c0323a42ed5034.spl_associated_token_account_interface.3b2836850a8d22fe-cgu.0.rcgu.o(".text._ZN38spl_associated_token_account_interface11instruction31create_associated_token_account17ha5bc9f139f0a932dE")
    *libanchor_lang-946a3f017ffdc240.rlib:anchor_lang-946a3f017ffdc240.anchor_lang.f942a28608b81895-cgu.0.rcgu.o(".text._ZN20solana_program_error95_$LT$impl$u20$core..convert..From$LT$solana_program_error..ProgramError$GT$$u20$for$u20$u64$GT$4from17ha8d6e2f735e6704fE")
    *libanchor_lang-946a3f017ffdc240.rlib:anchor_lang-946a3f017ffdc240.anchor_lang.f942a28608b81895-cgu.0.rcgu.o(".text._ZN42_$LT$$RF$T$u20$as$u20$core..fmt..Debug$GT$3fmt17h2e360ba5ddf25d35E")
    *libanchor_lang-946a3f017ffdc240.rlib:anchor_lang-946a3f017ffdc240.anchor_lang.f942a28608b81895-cgu.0.rcgu.o(".text._ZN44_$LT$$RF$T$u20$as$u20$core..fmt..Display$GT$3fmt17he1e148b42678abdeE")
    *libanchor_lang-946a3f017ffdc240.rlib:anchor_lang-946a3f017ffdc240.anchor_lang.f942a28608b81895-cgu.0.rcgu.o(".text._ZN44_$LT$$RF$T$u20$as$u20$core..fmt..Display$GT$3fmt17h580cc8a3577653e6E")
    *libanchor_lang-946a3f017ffdc240.rlib:anchor_lang-946a3f017ffdc240.anchor_lang.f942a28608b81895-cgu.0.rcgu.o(".text._ZN4core3fmt5Write9write_fmt17h3627d0645205828bE")
    *libanchor_lang-946a3f017ffdc240.rlib:anchor_lang-946a3f017ffdc240.anchor_lang.f942a28608b81895-cgu.0.rcgu.o(".text._ZN4core3fmt9Formatter9write_fmt17h3f6b819a15b06d5bE")
    *libanchor_lang-946a3f017ffdc240.rlib:anchor_lang-946a3f017ffdc240.anchor_lang.f942a28608b81895-cgu.0.rcgu.o(".text._ZN4core3ptr42drop_in_place$LT$alloc..string..String$GT$17he8c8e59492aff4e9E")
    *libanchor_lang-946a3f017ffdc240.rlib:anchor_lang-946a3f017ffdc240.anchor_lang.f942a28608b81895-cgu.0.rcgu.o(".text._ZN53_$LT$core..fmt..Error$u20$as$u20$core..fmt..Debug$GT$3fmt17haaa5bdc6ce3ebfafE")
    *libanchor_lang-946a3f017ffdc240.rlib:anchor_lang-946a3f017ffdc240.anchor_lang.f942a28608b81895-cgu.0.rcgu.o(".text._ZN58_$LT$alloc..string..String$u20$as$u20$core..fmt..Write$GT$10write_char17h6537f18e3aa683b6E")
    *libanchor_lang-946a3f017ffdc240.rlib:anchor_lang-946a3f017ffdc240.anchor_lang.f942a28608b81895-cgu.0.rcgu.o(".text._ZN58_$LT$alloc..string..String$u20$as$u20$core..fmt..Write$GT$9write_str17hca2d36081997e77fE")
    *libanchor_lang-946a3f017ffdc240.rlib:anchor_lang-946a3f017ffdc240.anchor_lang.f942a28608b81895-cgu.0.rcgu.o(".text.unlikely._ZN5alloc7raw_vec11finish_grow17h84123c7e62bf9009E")
    *libanchor_lang-946a3f017ffdc240.rlib:anchor_lang-946a3f017ffdc240.anchor_lang.f942a28608b81895-cgu.0.rcgu.o(".text.unlikely._ZN5alloc7raw_vec20RawVecInner$LT$A$GT$7reserve21do_reserve_and_handle17h0b022ec8ea8553d7E")
    *libanchor_lang-946a3f017ffdc240.rlib:anchor_lang-946a3f017ffdc240.anchor_lang.f942a28608b81895-cgu.0.rcgu.o(".text._ZN60_$LT$alloc..string..String$u20$as$u20$core..fmt..Display$GT$3fmt17h0abfe8bb398b04f9E")
    *libanchor_lang-946a3f017ffdc240.rlib:anchor_lang-946a3f017ffdc240.anchor_lang.f942a28608b81895-cgu.0.rcgu.o(".text._ZN71_$LT$solana_program_error..ProgramError$u20$as$u20$core..fmt..Debug$GT$3fmt17h6c1b6a595146bf75E")
    *libanchor_lang-946a3f017ffdc240.rlib:anchor_lang-946a3f017ffdc240.anchor_lang.f942a28608b81895-cgu.0.rcgu.o(".text._ZN87_$LT$T$u20$as$u20$alloc..slice..$LT$impl$u20$$u5b$T$u5d$$GT$..to_vec_in..ConvertVec$GT$6to_vec17h1a0addaaa4885f52E")
    *libanchor_lang-946a3f017ffdc240.rlib:anchor_lang-946a3f017ffdc240.anchor_lang.f942a28608b81895-cgu.0.rcgu.o(".text._ZN11anchor_lang8accounts12account_info90_$LT$impl$u20$anchor_lang..ToAccountInfos$u20$for$u20$solana_account_info..AccountInfo$GT$16to_account_infos17hc2a10c52ab27f83cE")
    *libanchor_lang-946a3f017ffdc240.rlib:anchor_lang-946a3f017ffdc240.anchor_lang.f942a28608b81895-cgu.0.rcgu.o(".text._ZN11anchor_lang8accounts6signer6Signer8try_from17h466e001d8ef8bb67E")
    *libanchor_lang-946a3f017ffdc240.rlib:anchor_lang-946a3f017ffdc240.anchor_lang.f942a28608b81895-cgu.0.rcgu.o(".text._ZN101_$LT$anchor_lang..bpf_writer..BpfWriter$LT$$RF$mut$u20$$u5b$u8$u5d$$GT$$u20$as$u20$std..io..Write$GT$9write_all17h43859a9989e4bbb8E")
    *libanchor_lang-946a3f017ffdc240.rlib:anchor_lang-946a3f017ffdc240.anchor_lang.f942a28608b81895-cgu.0.rcgu.o(".text._ZN11anchor_lang6common9is_closed17h06b8c9d6c00c256fE")
    *libanchor_lang-946a3f017ffdc240.rlib:anchor_lang-946a3f017ffdc240.anchor_lang.f942a28608b81895-cgu.0.rcgu.o(".text._ZN104_$LT$anchor_lang..error..Error$u20$as$u20$core..convert..From$LT$anchor_lang..error..AnchorError$GT$$GT$4from17hea8a2a88d69bafbdE")
    *libanchor_lang-946a3f017ffdc240.rlib:anchor_lang-946a3f017ffdc240.anchor_lang.f942a28608b81895-cgu.0.rcgu.o(".text._ZN107_$LT$anchor_lang..error..Error$u20$as$u20$core..convert..From$LT$solana_program_error..ProgramError$GT$$GT$4from17h1cb725ef91f52b34E")
    *libanchor_lang-946a3f017ffdc240.rlib:anchor_lang-946a3f017ffdc240.anchor_lang.f942a28608b81895-cgu.0.rcgu.o(".text._ZN11anchor_lang5error5Error3log17hd3ae822875284371E")
    *libanchor_lang-946a3f017ffdc240.rlib:anchor_lang-946a3f017ffdc240.anchor_lang.f942a28608b81895-cgu.0.rcgu.o(".text._ZN11anchor_lang5error5Error12with_pubkeys17hf915ec87f0cca876E")
    *libanchor_lang-946a3f017ffdc240.rlib:anchor_lang-946a3f017ffdc240.anchor_lang.f942a28608b81895-cgu.0.rcgu.o(".text._ZN11anchor_lang5error22ProgramErrorWithOrigin3log17h78ecfbb1001be728E")
    *libanchor_lang-946a3f017ffdc240.rlib:anchor_lang-946a3f017ffdc240.anchor_lang.f942a28608b81895-cgu.0.rcgu.o(".text._ZN11anchor_lang5error11AnchorError3log17h1fcb11e2b21406f1E")
    *libanchor_lang-946a3f017ffdc240.rlib:anchor_lang-946a3f017ffdc240.anchor_lang.f942a28608b81895-cgu.0.rcgu.o(".text._ZN11anchor_lang5error117_$LT$impl$u20$core..convert..From$LT$anchor_lang..error..Error$GT$$u20$for$u20$solana_program_error..ProgramError$GT$4from17hdd8ada28fea6ee42E")
    *libanchor_lang-946a3f017ffdc240.rlib:anchor_lang-946a3f017ffdc240.anchor_lang.f942a28608b81895-cgu.0.rcgu.o(".text._ZN11anchor_lang14system_program8allocate17hff8d2355a8a7ca76E")
    *libanchor_lang-946a3f017ffdc240.rlib:anchor_lang-946a3f017ffdc240.anchor_lang.f942a28608b81895-cgu.0.rcgu.o(".text._ZN11anchor_lang14system_program6assign17h652cd626f89354fbE")
    *libanchor_lang-946a3f017ffdc240.rlib:anchor_lang-946a3f017ffdc240.anchor_lang.f942a28608b81895-cgu.0.rcgu.o(".text._ZN11anchor_lang14system_program14create_account17hce90cbada1be5212E")
    *libanchor_lang-946a3f017ffdc240.rlib:anchor_lang-946a3f017ffdc240.anchor_lang.f942a28608b81895-cgu.0.rcgu.o(".text._ZN11anchor_lang14system_program8transfer17hd5a0855ca6790129E")
    *libanchor_lang-946a3f017ffdc240.rlib:anchor_lang-946a3f017ffdc240.anchor_lang.f942a28608b81895-cgu.0.rcgu.o(".text._ZN11anchor_lang14solana_program3log12sol_log_data17h4312eb5b2c5b2a02E")
    *libanchor_lang-946a3f017ffdc240.rlib:anchor_lang-946a3f017ffdc240.anchor_lang.f942a28608b81895-cgu.0.rcgu.o(".text._ZN11anchor_lang5error9ErrorCode4name17h1a15c64af47c865cE")
    *libanchor_lang-946a3f017ffdc240.rlib:anchor_lang-946a3f017ffdc240.anchor_lang.f942a28608b81895-cgu.0.rcgu.o(".text._ZN102_$LT$anchor_lang..error..Error$u20$as$u20$core..convert..From$LT$anchor_lang..error..ErrorCode$GT$$GT$4from17hf6afad09c3e27a81E")
    *libanchor_lang-946a3f017ffdc240.rlib:anchor_lang-946a3f017ffdc240.anchor_lang.f942a28608b81895-cgu.0.rcgu.o(".text._ZN68_$LT$anchor_lang..error..ErrorCode$u20$as$u20$core..fmt..Display$GT$3fmt17h179dd200a305e25eE")
    *libsolana_instructions_sysvar-9c4094ff215b55c8.rlib:solana_instructions_sysvar-9c4094ff215b55c8.solana_instructions_sysvar.dc50cba303356436-cgu.0.rcgu.o(".text.unlikely._ZN5alloc7raw_vec11finish_grow17h381fd9a2fc480573E")
    *libsolana_instructions_sysvar-9c4094ff215b55c8.rlib:solana_instructions_sysvar-9c4094ff215b55c8.solana_instructions_sysvar.dc50cba303356436-cgu.0.rcgu.o(".text._ZN5alloc7raw_vec19RawVec$LT$T$C$A$GT$8grow_one17h7d631054903b5511E")
    *libsolana_invoke-6f95e183a1727c78.rlib:solana_invoke-6f95e183a1727c78.solana_invoke.dfdcd03744ece765-cgu.0.rcgu.o(".text._ZN13solana_invoke6invoke17h1d28c059f58162e1E")
    *libsolana_invoke-6f95e183a1727c78.rlib:solana_invoke-6f95e183a1727c78.solana_invoke.dfdcd03744ece765-cgu.0.rcgu.o(".text._ZN13solana_invoke13invoke_signed17hdb4001abf6740cbbE")
    *libsolana_system_interface-458f09b56b32cdce.rlib:solana_system_interface-458f09b56b32cdce.solana_system_interface.71ab0bb93b9e7a82-cgu.0.rcgu.o(".text._ZN14solana_address1_80_$LT$impl$u20$serde_core..ser..Serialize$u20$for$u20$solana_address..Address$GT$9serialize17hd3e73d7efaa2243eE")
    *libsolana_system_interface-458f09b56b32cdce.rlib:solana_system_interface-458f09b56b32cdce.solana_system_interface.71ab0bb93b9e7a82-cgu.0.rcgu.o(".text._ZN18solana_instruction11Instruction16new_with_bincode17hb16d5f4440faece4E")
    *libsolana_system_interface-458f09b56b32cdce.rlib:solana_system_interface-458f09b56b32cdce.solana_system_interface.71ab0bb93b9e7a82-cgu.0.rcgu.o(".text._ZN42_$LT$$RF$T$u20$as$u20$core..fmt..Debug$GT$3fmt17ha7998b01ad43f000E")
    *libsolana_system_interface-458f09b56b32cdce.rlib:solana_system_interface-458f09b56b32cdce.solana_system_interface.71ab0bb93b9e7a82-cgu.0.rcgu.o(".text._ZN42_$LT$$RF$T$u20$as$u20$core..fmt..Debug$GT$3fmt17hd36612fcfe7cefb1E")
    *libsolana_system_interface-458f09b56b32cdce.rlib:solana_system_interface-458f09b56b32cdce.solana_system_interface.71ab0bb93b9e7a82-cgu.0.rcgu.o(".text._ZN42_$LT$$RF$T$u20$as$u20$core..fmt..Debug$GT$3fmt17h50c7532cef8a1cc7E")
    *libsolana_system_interface-458f09b56b32cdce.rlib:solana_system_interface-458f09b56b32cdce.solana_system_interface.71ab0bb93b9e7a82-cgu.0.rcgu.o(".text._ZN42_$LT$$RF$T$u20$as$u20$core..fmt..Debug$GT$3fmt17hf9d4af67c7a7fb44E")
    *libsolana_system_interface-458f09b56b32cdce.rlib:solana_system_interface-458f09b56b32cdce.solana_system_interface.71ab0bb93b9e7a82-cgu.0.rcgu.o(".text._ZN42_$LT$$RF$T$u20$as$u20$core..fmt..Debug$GT$3fmt17hac7d66634470c088E")
    *libsolana_system_interface-458f09b56b32cdce.rlib:solana_system_interface-458f09b56b32cdce.solana_system_interface.71ab0bb93b9e7a82-cgu.0.rcgu.o(".text._ZN42_$LT$$RF$T$u20$as$u20$core..fmt..Debug$GT$3fmt17h12a32f248da3517eE")
    *libsolana_system_interface-458f09b56b32cdce.rlib:solana_system_interface-458f09b56b32cdce.solana_system_interface.71ab0bb93b9e7a82-cgu.0.rcgu.o(".text._ZN4core3fmt3num52_$LT$impl$u20$core..fmt..Debug$u20$for$u20$usize$GT$3fmt17hdb1e4730d25472aaE")
    *libsolana_system_interface-458f09b56b32cdce.rlib:solana_system_interface-458f09b56b32cdce.solana_system_interface.71ab0bb93b9e7a82-cgu.0.rcgu.o(".text._ZN4core3ptr71drop_in_place$LT$alloc..boxed..Box$LT$bincode..error..ErrorKind$GT$$GT$17he74da7533bc32238E")
    *libsolana_system_interface-458f09b56b32cdce.rlib:solana_system_interface-458f09b56b32cdce.solana_system_interface.71ab0bb93b9e7a82-cgu.0.rcgu.o(".text.unlikely._ZN5alloc7raw_vec11finish_grow17ha5b7894c7a1fce32E")
    *libsolana_system_interface-458f09b56b32cdce.rlib:solana_system_interface-458f09b56b32cdce.solana_system_interface.71ab0bb93b9e7a82-cgu.0.rcgu.o(".text.unlikely._ZN5alloc7raw_vec20RawVecInner$LT$A$GT$7reserve21do_reserve_and_handle17hcf38e47d9e2432ecE")
    *libsolana_system_interface-458f09b56b32cdce.rlib:solana_system_interface-458f09b56b32cdce.solana_system_interface.71ab0bb93b9e7a82-cgu.0.rcgu.o(".text._ZN67_$LT$alloc..boxed..Box$LT$T$C$A$GT$$u20$as$u20$core..fmt..Debug$GT$3fmt17h380cc98bb1a83274E")
    *libsolana_system_interface-458f09b56b32cdce.rlib:solana_system_interface-458f09b56b32cdce.solana_system_interface.71ab0bb93b9e7a82-cgu.0.rcgu.o(".text._ZN23solana_system_interface11instruction14create_account17h30630444a5695b0bE")
    *libsolana_system_interface-458f09b56b32cdce.rlib:solana_system_interface-458f09b56b32cdce.solana_system_interface.71ab0bb93b9e7a82-cgu.0.rcgu.o(".text._ZN23solana_system_interface11instruction6assign17he3a2e582e774b3b6E")
    *libsolana_system_interface-458f09b56b32cdce.rlib:solana_system_interface-458f09b56b32cdce.solana_system_interface.71ab0bb93b9e7a82-cgu.0.rcgu.o(".text._ZN23solana_system_interface11instruction8transfer17h80708bdb2a8ed837E")
    *libsolana_system_interface-458f09b56b32cdce.rlib:solana_system_interface-458f09b56b32cdce.solana_system_interface.71ab0bb93b9e7a82-cgu.0.rcgu.o(".text._ZN23solana_system_interface11instruction8allocate17hb17ba01df62d6075E")
    *libsolana_sysvar-9deecc9fb9c7b8bf.rlib:solana_sysvar-9deecc9fb9c7b8bf.solana_sysvar.a081fd3bf1d74536-cgu.0.rcgu.o(".text._ZN13solana_sysvar5clock71_$LT$impl$u20$solana_sysvar..Sysvar$u20$for$u20$solana_clock..Clock$GT$3get17h4bfb4153e82302bcE")
    *libsolana_sysvar-9deecc9fb9c7b8bf.rlib:solana_sysvar-9deecc9fb9c7b8bf.solana_sysvar.a081fd3bf1d74536-cgu.0.rcgu.o(".text._ZN13solana_sysvar4rent69_$LT$impl$u20$solana_sysvar..Sysvar$u20$for$u20$solana_rent..Rent$GT$3get17h0c5cc173db3c7cb7E")
    *libsolana_rent-a7589d667235c67e.rlib:solana_rent-a7589d667235c67e.solana_rent.e996550a888ebe45-cgu.0.rcgu.o(".text._ZN11solana_rent4Rent15minimum_balance17he626e40bfed42442E")
    *libsolana_rent-a7589d667235c67e.rlib:solana_rent-a7589d667235c67e.solana_rent.e996550a888ebe45-cgu.0.rcgu.o(".text._ZN11solana_rent4Rent9is_exempt17hd5a83118aebfc397E")
    *libsolana_program_entrypoint-ef334bfa43d4eb53.rlib:solana_program_entrypoint-ef334bfa43d4eb53.solana_program_entrypoint.f381c88f0091cdab-cgu.0.rcgu.o(".text.unlikely._ZN5alloc7raw_vec11finish_grow17h7485876afd994792E")
    *libsolana_program_entrypoint-ef334bfa43d4eb53.rlib:solana_program_entrypoint-ef334bfa43d4eb53.solana_program_entrypoint.f381c88f0091cdab-cgu.0.rcgu.o(".text._ZN5alloc7raw_vec19RawVec$LT$T$C$A$GT$8grow_one17hd1e5703f8bfc5fe1E")
    *libsolana_program_entrypoint-ef334bfa43d4eb53.rlib:solana_program_entrypoint-ef334bfa43d4eb53.solana_program_entrypoint.f381c88f0091cdab-cgu.0.rcgu.o(".text._ZN25solana_program_entrypoint11deserialize17h9f789542de09de8fE")
    *libsolana_account_info-d4e387b23f687b92.rlib:solana_account_info-d4e387b23f687b92.solana_account_info.591c976e8af17f5-cgu.0.rcgu.o(".text._ZN5alloc2rc15Rc$LT$T$C$A$GT$9drop_slow17h74408dd96f5b64b1E")
    *libsolana_account_info-d4e387b23f687b92.rlib:solana_account_info-d4e387b23f687b92.solana_account_info.591c976e8af17f5-cgu.0.rcgu.o(".text._ZN5alloc2rc15Rc$LT$T$C$A$GT$9drop_slow17h0e448c29aa178b27E")
    *libsolana_account_info-d4e387b23f687b92.rlib:solana_account_info-d4e387b23f687b92.solana_account_info.591c976e8af17f5-cgu.0.rcgu.o(".text._ZN19solana_account_info11AccountInfo8lamports17h36ed6b0f7e87f6e0E")
    *libsolana_account_info-d4e387b23f687b92.rlib:solana_account_info-d4e387b23f687b92.solana_account_info.591c976e8af17f5-cgu.0.rcgu.o(".text._ZN19solana_account_info11AccountInfo8data_len17h62d29efe4706a1e0E")
    *libsolana_account_info-d4e387b23f687b92.rlib:solana_account_info-d4e387b23f687b92.solana_account_info.591c976e8af17f5-cgu.0.rcgu.o(".text._ZN19solana_account_info11AccountInfo12try_data_len17h26dd0cc2af6c2e3fE")
    *libsolana_account_info-d4e387b23f687b92.rlib:solana_account_info-d4e387b23f687b92.solana_account_info.591c976e8af17f5-cgu.0.rcgu.o(".text._ZN19solana_account_info11AccountInfo13data_is_empty17hcc9f57c6fdfa964aE")
    *libsolana_account_info-d4e387b23f687b92.rlib:solana_account_info-d4e387b23f687b92.solana_account_info.591c976e8af17f5-cgu.0.rcgu.o(".text._ZN19solana_account_info11AccountInfo6resize17hb7fc2e57fa7957c1E")
    *libsolana_account_info-d4e387b23f687b92.rlib:solana_account_info-d4e387b23f687b92.solana_account_info.591c976e8af17f5-cgu.0.rcgu.o(".text._ZN19solana_account_info11AccountInfo3new17ha8c63b981695b387E")
    *libsolana_instruction-97febfa94ba2110b.rlib:solana_instruction-97febfa94ba2110b.solana_instruction.5e51609c6af3fab9-cgu.0.rcgu.o(".text._ZN18solana_instruction11Instruction14new_with_bytes17h02bcc8c81998f5c7E")
    *libsolana_address-c4b6fa67093b2583.rlib:solana_address-c4b6fa67093b2583.solana_address.5b6ba6fef0ac183a-cgu.0.rcgu.o(".text._ZN14solana_address8syscalls41_$LT$impl$u20$solana_address..Address$GT$3log17h76f136d2c146a1c9E")
    *libsolana_address-c4b6fa67093b2583.rlib:solana_address-c4b6fa67093b2583.solana_address.5b6ba6fef0ac183a-cgu.0.rcgu.o(".text._ZN14solana_address15write_as_base5817h08f3935654efb1b3E")
    *libsolana_address-c4b6fa67093b2583.rlib:solana_address-c4b6fa67093b2583.solana_address.5b6ba6fef0ac183a-cgu.0.rcgu.o(".text._ZN60_$LT$solana_address..Address$u20$as$u20$core..fmt..Debug$GT$3fmt17h9abcfe2882d56ee9E")
    *libsolana_program_error-83969cbe5ffdafaa.rlib:solana_program_error-83969cbe5ffdafaa.solana_program_error.77a8c21d6749471d-cgu.0.rcgu.o(".text._ZN45_$LT$$RF$T$u20$as$u20$core..fmt..LowerHex$GT$3fmt17h62af71d0c27b2cfaE")
    *libsolana_program_error-83969cbe5ffdafaa.rlib:solana_program_error-83969cbe5ffdafaa.solana_program_error.77a8c21d6749471d-cgu.0.rcgu.o(".text._ZN73_$LT$solana_program_error..ProgramError$u20$as$u20$core..fmt..Display$GT$3fmt17h872a086e0732beb6E")
    *libborsh-0f675040a49f1e19.rlib:borsh-0f675040a49f1e19.borsh.dffbb1e563291a07-cgu.0.rcgu.o(".text._ZN5borsh2de44unexpected_eof_to_unexpected_length_of_input17h2b5c9351fa7811caE")
    *libstd-30a182e154ee17f6.rlib:std-30a182e154ee17f6.std.27cd147212409ffc-cgu.0.rcgu.o(".text._ZN42_$LT$$RF$T$u20$as$u20$core..fmt..Debug$GT$3fmt17h26aee6fb7680932bE")
    *libstd-30a182e154ee17f6.rlib:std-30a182e154ee17f6.std.27cd147212409ffc-cgu.0.rcgu.o(".text._ZN42_$LT$$RF$T$u20$as$u20$core..fmt..Debug$GT$3fmt17hda68c1c7f1c5726fE")
    *libstd-30a182e154ee17f6.rlib:std-30a182e154ee17f6.std.27cd147212409ffc-cgu.0.rcgu.o(".text._ZN4core3fmt3num50_$LT$impl$u20$core..fmt..Debug$u20$for$u20$i32$GT$3fmt17hca1ee99b9602d046E")
    *libstd-30a182e154ee17f6.rlib:std-30a182e154ee17f6.std.27cd147212409ffc-cgu.0.rcgu.o(".text._ZN4core3ptr238drop_in_place$LT$alloc..boxed..convert..$LT$impl$u20$core..convert..From$LT$alloc..string..String$GT$$u20$for$u20$alloc..boxed..Box$LT$dyn$u20$core..error..Error$u2b$core..marker..Sync$u2b$core..marker..Send$GT$$GT$..from..StringError$GT$17h8316abae74cf92b4E")
    *libstd-30a182e154ee17f6.rlib:std-30a182e154ee17f6.std.27cd147212409ffc-cgu.0.rcgu.o(".text._ZN4core3ptr42drop_in_place$LT$alloc..string..String$GT$17h2cc6d5c97f8ca76fE")
    *libstd-30a182e154ee17f6.rlib:std-30a182e154ee17f6.std.27cd147212409ffc-cgu.0.rcgu.o(".text._ZN4core5error5Error5cause17hb0eb8cc32d3b0cc7E")
    *libstd-30a182e154ee17f6.rlib:std-30a182e154ee17f6.std.27cd147212409ffc-cgu.0.rcgu.o(".text._ZN4core5error5Error7provide17h80575cc6999f5459E")
    *libstd-30a182e154ee17f6.rlib:std-30a182e154ee17f6.std.27cd147212409ffc-cgu.0.rcgu.o(".text._ZN4core5error5Error7type_id17h9b5908a8d5c815c6E")
    *libstd-30a182e154ee17f6.rlib:std-30a182e154ee17f6.std.27cd147212409ffc-cgu.0.rcgu.o(".text._ZN58_$LT$alloc..string..String$u20$as$u20$core..fmt..Debug$GT$3fmt17hf720a149603ffe39E")
    *libstd-30a182e154ee17f6.rlib:std-30a182e154ee17f6.std.27cd147212409ffc-cgu.0.rcgu.o(".text._ZN58_$LT$std..io..error..Error$u20$as$u20$core..fmt..Debug$GT$3fmt17h10f07c55682c7dbdE")
    *libstd-30a182e154ee17f6.rlib:std-30a182e154ee17f6.std.27cd147212409ffc-cgu.0.rcgu.o(".text._ZN3std2io5error5Error3new17h11149d8495b68af6E")
    *libstd-30a182e154ee17f6.rlib:std-30a182e154ee17f6.std.27cd147212409ffc-cgu.0.rcgu.o(".text._ZN3std2io5error5Error4_new17hf437cdaea4dfb409E")
    *libstd-30a182e154ee17f6.rlib:std-30a182e154ee17f6.std.27cd147212409ffc-cgu.0.rcgu.o(".text._ZN3std2io5error83_$LT$impl$u20$core..fmt..Debug$u20$for$u20$std..io..error..repr_bitpacked..Repr$GT$3fmt17h9de5ded71ec5b85cE")
    *libstd-30a182e154ee17f6.rlib:std-30a182e154ee17f6.std.27cd147212409ffc-cgu.0.rcgu.o(".text.unlikely._ZN3std7process5abort17hb785e15ccb55d64fE")
    *libstd-30a182e154ee17f6.rlib:std-30a182e154ee17f6.std.27cd147212409ffc-cgu.0.rcgu.o(".text.unlikely._RNvCscR3e5J6VSLN_7___rustc17rust_begin_unwind")
    *libstd-30a182e154ee17f6.rlib:std-30a182e154ee17f6.std.27cd147212409ffc-cgu.0.rcgu.o(".text._ZN62_$LT$std..io..error..ErrorKind$u20$as$u20$core..fmt..Debug$GT$3fmt17hf18d8e634ec28c8dE")
    *libstd-30a182e154ee17f6.rlib:std-30a182e154ee17f6.std.27cd147212409ffc-cgu.0.rcgu.o(".text._ZN3std3sys3pal3sbf7sol_log17h46ed93fe6cb4860cE")
    *libstd-30a182e154ee17f6.rlib:std-30a182e154ee17f6.std.27cd147212409ffc-cgu.0.rcgu.o(".text.unlikely._ZN3std3sys3pal3sbf5panic17h5e030c92e3e5e13aE")
    *libstd-30a182e154ee17f6.rlib:std-30a182e154ee17f6.std.27cd147212409ffc-cgu.0.rcgu.o(".text.unlikely._ZN3std3sys3pal3sbf14abort_internal17h189f9bb5936a955cE")
    *libstd-30a182e154ee17f6.rlib:std-30a182e154ee17f6.std.27cd147212409ffc-cgu.0.rcgu.o(".text.unlikely._ZN3std5alloc8rust_oom17h1a558e7cdbaf7cc1E")
    *libstd-30a182e154ee17f6.rlib:std-30a182e154ee17f6.std.27cd147212409ffc-cgu.0.rcgu.o(".text.unlikely._RNvCscR3e5J6VSLN_7___rustc8___rg_oom")
    *libhashbrown-49b376391f564566.rlib:hashbrown-49b376391f564566.hashbrown.964eec3a69d8a95e-cgu.0.rcgu.o(".text._ZN9hashbrown3raw11Fallibility17capacity_overflow17ha291a070a3eb228cE")
    *libhashbrown-49b376391f564566.rlib:hashbrown-49b376391f564566.hashbrown.964eec3a69d8a95e-cgu.0.rcgu.o(".text._ZN9hashbrown3raw11Fallibility9alloc_err17he0550021a26b9606E")
    *liballoc-91c82d13bc4939af.rlib:alloc-91c82d13bc4939af.alloc.555e7509368aade7-cgu.0.rcgu.o(".text._ZN4core3fmt5Write9write_fmt17hb93e2ea2789364caE")
    *liballoc-91c82d13bc4939af.rlib:alloc-91c82d13bc4939af.alloc.555e7509368aade7-cgu.0.rcgu.o(".text._ZN4core3ptr42drop_in_place$LT$alloc..string..String$GT$17h6cc142a95ab821b1E")
    *liballoc-91c82d13bc4939af.rlib:alloc-91c82d13bc4939af.alloc.555e7509368aade7-cgu.0.rcgu.o(".text._ZN53_$LT$core..fmt..Error$u20$as$u20$core..fmt..Debug$GT$3fmt17haaa5bdc6ce3ebfafE")
    *liballoc-91c82d13bc4939af.rlib:alloc-91c82d13bc4939af.alloc.555e7509368aade7-cgu.0.rcgu.o(".text.unlikely._ZN5alloc7raw_vec17capacity_overflow17hb35234d8fde76484E")
    *liballoc-91c82d13bc4939af.rlib:alloc-91c82d13bc4939af.alloc.555e7509368aade7-cgu.0.rcgu.o(".text.unlikely._ZN5alloc7raw_vec20RawVecInner$LT$A$GT$7reserve21do_reserve_and_handle17h723c6e260acabf7cE")
    *liballoc-91c82d13bc4939af.rlib:alloc-91c82d13bc4939af.alloc.555e7509368aade7-cgu.0.rcgu.o(".text.unlikely._ZN5alloc7raw_vec11finish_grow17h726e8a9d8127cc67E")
    *liballoc-91c82d13bc4939af.rlib:alloc-91c82d13bc4939af.alloc.555e7509368aade7-cgu.0.rcgu.o(".text.unlikely._ZN5alloc7raw_vec12handle_error17h49931f096d3db69aE")
    *liballoc-91c82d13bc4939af.rlib:alloc-91c82d13bc4939af.alloc.555e7509368aade7-cgu.0.rcgu.o(".text.unlikely._ZN5alloc5alloc18handle_alloc_error17hdecd2d8ca4c9b5bbE")
    *liballoc-91c82d13bc4939af.rlib:alloc-91c82d13bc4939af.alloc.555e7509368aade7-cgu.0.rcgu.o(".text._ZN256_$LT$alloc..boxed..convert..$LT$impl$u20$core..convert..From$LT$alloc..string..String$GT$$u20$for$u20$alloc..boxed..Box$LT$dyn$u20$core..error..Error$u2b$core..marker..Sync$u2b$core..marker..Send$GT$$GT$..from..StringError$u20$as$u20$core..error..Error$GT$11description17h4f1e64f34513d1a7E")
    *liballoc-91c82d13bc4939af.rlib:alloc-91c82d13bc4939af.alloc.555e7509368aade7-cgu.0.rcgu.o(".text._ZN256_$LT$alloc..boxed..convert..$LT$impl$u20$core..convert..From$LT$alloc..string..String$GT$$u20$for$u20$alloc..boxed..Box$LT$dyn$u20$core..error..Error$u2b$core..marker..Sync$u2b$core..marker..Send$GT$$GT$..from..StringError$u20$as$u20$core..fmt..Display$GT$3fmt17hb11f259b86c7ce07E")
    *liballoc-91c82d13bc4939af.rlib:alloc-91c82d13bc4939af.alloc.555e7509368aade7-cgu.0.rcgu.o(".text._ZN254_$LT$alloc..boxed..convert..$LT$impl$u20$core..convert..From$LT$alloc..string..String$GT$$u20$for$u20$alloc..boxed..Box$LT$dyn$u20$core..error..Error$u2b$core..marker..Sync$u2b$core..marker..Send$GT$$GT$..from..StringError$u20$as$u20$core..fmt..Debug$GT$3fmt17hc16cdd4affb20139E")
    *liballoc-91c82d13bc4939af.rlib:alloc-91c82d13bc4939af.alloc.555e7509368aade7-cgu.0.rcgu.o(".text._ZN5alloc3fmt6format12format_inner17h36b493547a55b45dE")
    *liballoc-91c82d13bc4939af.rlib:alloc-91c82d13bc4939af.alloc.555e7509368aade7-cgu.0.rcgu.o(".text._ZN58_$LT$alloc..string..String$u20$as$u20$core..fmt..Write$GT$9write_str17hca2d36081997e77fE")
    *liballoc-91c82d13bc4939af.rlib:alloc-91c82d13bc4939af.alloc.555e7509368aade7-cgu.0.rcgu.o(".text._ZN58_$LT$alloc..string..String$u20$as$u20$core..fmt..Write$GT$10write_char17h6537f18e3aa683b6E")
    *libcore-673053c840437f62.rlib:core-673053c840437f62.core.e65e0c7e339ea620-cgu.0.rcgu.o(".text._ZN71_$LT$core..ops..range..Range$LT$Idx$GT$$u20$as$u20$core..fmt..Debug$GT$3fmt17hc74cdea0260d66aeE")
    *libcore-673053c840437f62.rlib:core-673053c840437f62.core.e65e0c7e339ea620-cgu.0.rcgu.o(".text._ZN62_$LT$core..cell..BorrowError$u20$as$u20$core..fmt..Display$GT$3fmt17h3a77ba6c4ee4b0aaE")
    *libcore-673053c840437f62.rlib:core-673053c840437f62.core.e65e0c7e339ea620-cgu.0.rcgu.o(".text.unlikely._ZN4core4cell30panic_already_mutably_borrowed17h3f8a590091336958E")
    *libcore-673053c840437f62.rlib:core-673053c840437f62.core.e65e0c7e339ea620-cgu.0.rcgu.o(".text._ZN4core4char7methods22_$LT$impl$u20$char$GT$16escape_debug_ext17h8e39e5bdc678cbf9E")
    *libcore-673053c840437f62.rlib:core-673053c840437f62.core.e65e0c7e339ea620-cgu.0.rcgu.o(".text.unlikely._ZN4core6option13unwrap_failed17h2d9b86860954c5aeE")
    *libcore-673053c840437f62.rlib:core-673053c840437f62.core.e65e0c7e339ea620-cgu.0.rcgu.o(".text.unlikely._ZN4core9panicking9panic_fmt17hd057c6f753903b3bE")
    *libcore-673053c840437f62.rlib:core-673053c840437f62.core.e65e0c7e339ea620-cgu.0.rcgu.o(".text.unlikely._ZN4core9panicking5panic17h9e86d515c1725fb5E")
    *libcore-673053c840437f62.rlib:core-673053c840437f62.core.e65e0c7e339ea620-cgu.0.rcgu.o(".text.unlikely._ZN4core9panicking18panic_bounds_check17hf0c02a9253951be5E")
    *libcore-673053c840437f62.rlib:core-673053c840437f62.core.e65e0c7e339ea620-cgu.0.rcgu.o(".text.unlikely._ZN4core6result13unwrap_failed17h5a0595231043dbf9E")
    *libcore-673053c840437f62.rlib:core-673053c840437f62.core.e65e0c7e339ea620-cgu.0.rcgu.o(".text._ZN68_$LT$core..fmt..builders..PadAdapter$u20$as$u20$core..fmt..Write$GT$9write_str17h07b1cfaa048142fbE")
    *libcore-673053c840437f62.rlib:core-673053c840437f62.core.e65e0c7e339ea620-cgu.0.rcgu.o(".text._ZN68_$LT$core..fmt..builders..PadAdapter$u20$as$u20$core..fmt..Write$GT$10write_char17he754e8861ee9982cE")
    *libcore-673053c840437f62.rlib:core-673053c840437f62.core.e65e0c7e339ea620-cgu.0.rcgu.o(".text._ZN4core3fmt8builders11DebugStruct5field17h7c3cf5643de20b65E")
    *libcore-673053c840437f62.rlib:core-673053c840437f62.core.e65e0c7e339ea620-cgu.0.rcgu.o(".text._ZN4core3fmt8builders11DebugStruct6finish17h4efe41d9b850ea80E")
    *libcore-673053c840437f62.rlib:core-673053c840437f62.core.e65e0c7e339ea620-cgu.0.rcgu.o(".text._ZN4core3fmt8builders10DebugTuple5field17h07f284e029b65ac5E")
    *libcore-673053c840437f62.rlib:core-673053c840437f62.core.e65e0c7e339ea620-cgu.0.rcgu.o(".text._ZN4core3fmt8builders10DebugTuple6finish17h20638c02b3cc7b82E")
    *libcore-673053c840437f62.rlib:core-673053c840437f62.core.e65e0c7e339ea620-cgu.0.rcgu.o(".text._ZN4core3fmt5Write9write_fmt17h085a20d0e6cb78c5E")
    *libcore-673053c840437f62.rlib:core-673053c840437f62.core.e65e0c7e339ea620-cgu.0.rcgu.o(".text._ZN4core3fmt5write17h6598dd1fd9735818E")
    *libcore-673053c840437f62.rlib:core-673053c840437f62.core.e65e0c7e339ea620-cgu.0.rcgu.o(".text._ZN4core3fmt9Formatter12pad_integral17h5db7dcc7186aa7b9E")
    *libcore-673053c840437f62.rlib:core-673053c840437f62.core.e65e0c7e339ea620-cgu.0.rcgu.o(".text._ZN4core3fmt9Formatter12pad_integral12write_prefix17h8540d140f3ea9e8aE")
    *libcore-673053c840437f62.rlib:core-673053c840437f62.core.e65e0c7e339ea620-cgu.0.rcgu.o(".text._ZN4core3fmt9Formatter3pad17h9fe7d713aebd4bf2E")
    *libcore-673053c840437f62.rlib:core-673053c840437f62.core.e65e0c7e339ea620-cgu.0.rcgu.o(".text._ZN4core3fmt9Formatter9write_str17h969f1c036f9c0313E")
    *libcore-673053c840437f62.rlib:core-673053c840437f62.core.e65e0c7e339ea620-cgu.0.rcgu.o(".text._ZN4core3fmt9Formatter12debug_struct17h3703beb303cfa4c5E")
    *libcore-673053c840437f62.rlib:core-673053c840437f62.core.e65e0c7e339ea620-cgu.0.rcgu.o(".text._ZN4core3fmt9Formatter26debug_struct_field2_finish17h115cad4bd41b5c4dE")
    *libcore-673053c840437f62.rlib:core-673053c840437f62.core.e65e0c7e339ea620-cgu.0.rcgu.o(".text._ZN4core3fmt9Formatter11debug_tuple17h92a3ad57be6ee082E")
    *libcore-673053c840437f62.rlib:core-673053c840437f62.core.e65e0c7e339ea620-cgu.0.rcgu.o(".text._ZN4core3fmt9Formatter25debug_tuple_field1_finish17ha04ac01d5860eb24E")
    *libcore-673053c840437f62.rlib:core-673053c840437f62.core.e65e0c7e339ea620-cgu.0.rcgu.o(".text._ZN40_$LT$str$u20$as$u20$core..fmt..Debug$GT$3fmt17h90c958a145934ae7E")
    *libcore-673053c840437f62.rlib:core-673053c840437f62.core.e65e0c7e339ea620-cgu.0.rcgu.o(".text._ZN42_$LT$str$u20$as$u20$core..fmt..Display$GT$3fmt17haf5cf6b179ff776eE")
    *libcore-673053c840437f62.rlib:core-673053c840437f62.core.e65e0c7e339ea620-cgu.0.rcgu.o(".text._ZN41_$LT$char$u20$as$u20$core..fmt..Debug$GT$3fmt17h085a8c0784802dc0E")
    *libcore-673053c840437f62.rlib:core-673053c840437f62.core.e65e0c7e339ea620-cgu.0.rcgu.o(".text.unlikely._ZN4core5slice5index26slice_start_index_len_fail17h67830a8602ab6cd3E")
    *libcore-673053c840437f62.rlib:core-673053c840437f62.core.e65e0c7e339ea620-cgu.0.rcgu.o(".text.unlikely._ZN4core5slice5index24slice_end_index_len_fail17h1f4e9e019b5e2314E")
    *libcore-673053c840437f62.rlib:core-673053c840437f62.core.e65e0c7e339ea620-cgu.0.rcgu.o(".text.unlikely._ZN4core5slice5index22slice_index_order_fail17h80817da18ae50333E")
    *libcore-673053c840437f62.rlib:core-673053c840437f62.core.e65e0c7e339ea620-cgu.0.rcgu.o(".text._ZN4core3str5count14do_count_chars17h5edf8ed4356233f2E")
    *libcore-673053c840437f62.rlib:core-673053c840437f62.core.e65e0c7e339ea620-cgu.0.rcgu.o(".text.unlikely._ZN4core3str16slice_error_fail17h758cfb41ee03f598E")
    *libcore-673053c840437f62.rlib:core-673053c840437f62.core.e65e0c7e339ea620-cgu.0.rcgu.o(".text._ZN4core3str19slice_error_fail_rt17hc7045508a0dabd71E")
    *libcore-673053c840437f62.rlib:core-673053c840437f62.core.e65e0c7e339ea620-cgu.0.rcgu.o(".text._ZN4core7unicode9printable5check17h23d5580a309014c9E")
    *libcore-673053c840437f62.rlib:core-673053c840437f62.core.e65e0c7e339ea620-cgu.0.rcgu.o(".text._ZN4core7unicode9printable12is_printable17h77c2525936026c86E")
    *libcore-673053c840437f62.rlib:core-673053c840437f62.core.e65e0c7e339ea620-cgu.0.rcgu.o(".text.unlikely._ZN4core9panicking11panic_const24panic_const_add_overflow17h3493e0c6194f31d7E")
    *libcore-673053c840437f62.rlib:core-673053c840437f62.core.e65e0c7e339ea620-cgu.0.rcgu.o(".text.unlikely._ZN4core9panicking11panic_const24panic_const_sub_overflow17h73105958df4c0d1cE")
    *libcore-673053c840437f62.rlib:core-673053c840437f62.core.e65e0c7e339ea620-cgu.0.rcgu.o(".text.unlikely._ZN4core9panicking11panic_const24panic_const_mul_overflow17h7c8001528ea4174dE")
    *libcore-673053c840437f62.rlib:core-673053c840437f62.core.e65e0c7e339ea620-cgu.0.rcgu.o(".text._ZN4core3fmt3num52_$LT$impl$u20$core..fmt..LowerHex$u20$for$u20$i8$GT$3fmt17haa6262e9f1b514dfE")
    *libcore-673053c840437f62.rlib:core-673053c840437f62.core.e65e0c7e339ea620-cgu.0.rcgu.o(".text._ZN4core3fmt3num52_$LT$impl$u20$core..fmt..UpperHex$u20$for$u20$i8$GT$3fmt17h865719d394404866E")
    *libcore-673053c840437f62.rlib:core-673053c840437f62.core.e65e0c7e339ea620-cgu.0.rcgu.o(".text._ZN4core3fmt3num53_$LT$impl$u20$core..fmt..LowerHex$u20$for$u20$i32$GT$3fmt17hd6b591b3de4bff16E")
    *libcore-673053c840437f62.rlib:core-673053c840437f62.core.e65e0c7e339ea620-cgu.0.rcgu.o(".text._ZN4core3fmt3num53_$LT$impl$u20$core..fmt..UpperHex$u20$for$u20$i32$GT$3fmt17h26f1f2b9a04d48abE")
    *libcore-673053c840437f62.rlib:core-673053c840437f62.core.e65e0c7e339ea620-cgu.0.rcgu.o(".text._ZN4core3fmt3num53_$LT$impl$u20$core..fmt..LowerHex$u20$for$u20$i64$GT$3fmt17h152865ae223db4b8E")
    *libcore-673053c840437f62.rlib:core-673053c840437f62.core.e65e0c7e339ea620-cgu.0.rcgu.o(".text._ZN4core3fmt3num53_$LT$impl$u20$core..fmt..UpperHex$u20$for$u20$i64$GT$3fmt17hbb1080c240f8d273E")
    *libcore-673053c840437f62.rlib:core-673053c840437f62.core.e65e0c7e339ea620-cgu.0.rcgu.o(".text._ZN4core3fmt3num52_$LT$impl$u20$core..fmt..Debug$u20$for$u20$usize$GT$3fmt17hdb1e4730d25472aaE")
    *libcore-673053c840437f62.rlib:core-673053c840437f62.core.e65e0c7e339ea620-cgu.0.rcgu.o(".text._ZN4core3fmt3num3imp51_$LT$impl$u20$core..fmt..Display$u20$for$u20$u8$GT$3fmt17h54c5bebdfae9905eE")
    *libcore-673053c840437f62.rlib:core-673053c840437f62.core.e65e0c7e339ea620-cgu.0.rcgu.o(".text._ZN4core3fmt3num3imp20_$LT$impl$u20$u8$GT$4_fmt17hb959e6e97e52f102E")
    *libcore-673053c840437f62.rlib:core-673053c840437f62.core.e65e0c7e339ea620-cgu.0.rcgu.o(".text._ZN4core3fmt3num3imp52_$LT$impl$u20$core..fmt..Display$u20$for$u20$u32$GT$3fmt17h4914e23be7844e54E")
    *libcore-673053c840437f62.rlib:core-673053c840437f62.core.e65e0c7e339ea620-cgu.0.rcgu.o(".text._ZN4core3fmt3num3imp52_$LT$impl$u20$core..fmt..Display$u20$for$u20$i32$GT$3fmt17h6111f563f46b6dc2E")
    *libcore-673053c840437f62.rlib:core-673053c840437f62.core.e65e0c7e339ea620-cgu.0.rcgu.o(".text._ZN4core3fmt3num3imp21_$LT$impl$u20$u32$GT$4_fmt17h92f5710b9e1a67e8E")
    *libcore-673053c840437f62.rlib:core-673053c840437f62.core.e65e0c7e339ea620-cgu.0.rcgu.o(".text._ZN4core3fmt3num3imp52_$LT$impl$u20$core..fmt..Display$u20$for$u20$u64$GT$3fmt17hb4b04baeaa01359fE")
    *libcore-673053c840437f62.rlib:core-673053c840437f62.core.e65e0c7e339ea620-cgu.0.rcgu.o(".text._ZN4core3fmt3num3imp21_$LT$impl$u20$u64$GT$4_fmt17h25fce7c7a9cb3ccfE")
    *libcore-673053c840437f62.rlib:core-673053c840437f62.core.e65e0c7e339ea620-cgu.0.rcgu.o(".text._ZN42_$LT$$RF$T$u20$as$u20$core..fmt..Debug$GT$3fmt17h0c058cd771a6cfd7E")
    *libcore-673053c840437f62.rlib:core-673053c840437f62.core.e65e0c7e339ea620-cgu.0.rcgu.o(".text._ZN44_$LT$$RF$T$u20$as$u20$core..fmt..Display$GT$3fmt17hf98bacc17f6ab5f4E")
    *libcore-673053c840437f62.rlib:core-673053c840437f62.core.e65e0c7e339ea620-cgu.0.rcgu.o(".text.unlikely._ZN4core5slice5index26slice_start_index_len_fail8do_panic7runtime17hbfc67de29d3cd273E")
    *libcore-673053c840437f62.rlib:core-673053c840437f62.core.e65e0c7e339ea620-cgu.0.rcgu.o(".text.unlikely._ZN4core5slice5index24slice_end_index_len_fail8do_panic7runtime17h2c6c50df44ce9817E")
    *libcore-673053c840437f62.rlib:core-673053c840437f62.core.e65e0c7e339ea620-cgu.0.rcgu.o(".text.unlikely._ZN4core5slice5index22slice_index_order_fail8do_panic7runtime17hab9d550cdf90aa9cE")
    *libcore-673053c840437f62.rlib:core-673053c840437f62.core.e65e0c7e339ea620-cgu.0.rcgu.o(".text._ZN4core7unicode12unicode_data15grapheme_extend11lookup_slow17h3de7df68a4b16d65E")
    *libcompiler_builtins-3449fbafc948693e.rlib:compiler_builtins-3449fbafc948693e.compiler_builtins.6ccb59b2cefd2cdd-cgu.114.rcgu.o(".text.memcpy")
    *libcompiler_builtins-3449fbafc948693e.rlib:compiler_builtins-3449fbafc948693e.compiler_builtins.6ccb59b2cefd2cdd-cgu.114.rcgu.o(".text.memmove")
    *libcompiler_builtins-3449fbafc948693e.rlib:compiler_builtins-3449fbafc948693e.compiler_builtins.6ccb59b2cefd2cdd-cgu.114.rcgu.o(".text.memset")
    *libcompiler_builtins-3449fbafc948693e.rlib:compiler_builtins-3449fbafc948693e.compiler_builtins.6ccb59b2cefd2cdd-cgu.114.rcgu.o(".text.memcmp")
    *libcompiler_builtins-3449fbafc948693e.rlib:compiler_builtins-3449fbafc948693e.compiler_builtins.6ccb59b2cefd2cdd-cgu.148.rcgu.o(".text.__udivti3")
    *libcompiler_builtins-3449fbafc948693e.rlib:compiler_builtins-3449fbafc948693e.compiler_builtins.6ccb59b2cefd2cdd-cgu.012.rcgu.o(".text._ZN17compiler_builtins3int19specialized_div_rem12u128_div_rem17h79f8b203ef37c50bE")
    *libcompiler_builtins-3449fbafc948693e.rlib:compiler_builtins-3449fbafc948693e.compiler_builtins.6ccb59b2cefd2cdd-cgu.153.rcgu.o(".text.__floatundidf")
    *libcompiler_builtins-3449fbafc948693e.rlib:compiler_builtins-3449fbafc948693e.compiler_builtins.6ccb59b2cefd2cdd-cgu.158.rcgu.o(".text.__gedf2")
    *libcompiler_builtins-3449fbafc948693e.rlib:compiler_builtins-3449fbafc948693e.compiler_builtins.6ccb59b2cefd2cdd-cgu.172.rcgu.o(".text.__muldf3")
    *libcompiler_builtins-3449fbafc948693e.rlib:compiler_builtins-3449fbafc948693e.compiler_builtins.6ccb59b2cefd2cdd-cgu.004.rcgu.o(".text._ZN17compiler_builtins5float3mul8__muldf317h541a3f2bd4b92bbdE")
    *libcompiler_builtins-3449fbafc948693e.rlib:compiler_builtins-3449fbafc948693e.compiler_builtins.6ccb59b2cefd2cdd-cgu.228.rcgu.o(".text.__fixunsdfdi")
    *libcompiler_builtins-3449fbafc948693e.rlib:compiler_builtins-3449fbafc948693e.compiler_builtins.6ccb59b2cefd2cdd-cgu.244.rcgu.o(".text.__ashlti3")
    *libcompiler_builtins-3449fbafc948693e.rlib:compiler_builtins-3449fbafc948693e.compiler_builtins.6ccb59b2cefd2cdd-cgu.269.rcgu.o(".text.__lshrti3")
    *libcompiler_builtins-3449fbafc948693e.rlib:compiler_builtins-3449fbafc948693e.compiler_builtins.6ccb59b2cefd2cdd-cgu.304.rcgu.o(".text.__multi3")
    *libcompiler_builtins-3449fbafc948693e.rlib:compiler_builtins-3449fbafc948693e.compiler_builtins.6ccb59b2cefd2cdd-cgu.315.rcgu.o(".text.__gtdf2")
    *mayhem_recovered.mayhem_recovered.a46a1b6815b9c4-cgu.0.rcgu.o(".text._ZN49_$LT$T$u20$as$u20$alloc..string..SpecToString$GT$14spec_to_string17hb732b12126722a1bE")
    *mayhem_recovered.mayhem_recovered.a46a1b6815b9c4-cgu.0.rcgu.o(".text._ZN4core3ptr85drop_in_place$LT$core..result..Result$LT$$LP$$RP$$C$anchor_lang..error..Error$GT$$GT$17he12e19e6ab719f9aE")
    *mayhem_recovered.mayhem_recovered.a46a1b6815b9c4-cgu.0.rcgu.o(".text._ZN16mayhem_recovered12instructions13buy_pump_swap4math17h766ca80dd7c4fbd3E")
    *mayhem_recovered.mayhem_recovered.a46a1b6815b9c4-cgu.0.rcgu.o(".text._ZN16mayhem_recovered12instructions18pump_amm_interface14bought_amounts17h656f4a27a07b4ddaE")
    *mayhem_recovered.mayhem_recovered.a46a1b6815b9c4-cgu.0.rcgu.o(".text._ZN16mayhem_recovered15sweep_remaining17h5d885e50f6cbf780E")
    *mayhem_recovered.mayhem_recovered.a46a1b6815b9c4-cgu.0.rcgu.o(".text._ZN16mayhem_recovered112_$LT$impl$u20$core..convert..From$LT$mayhem_recovered..MayhemError$GT$$u20$for$u20$anchor_lang..error..Error$GT$4from17h26d6ff16377664e2E")
    *(.text*)
  } :text
  .rodata : { *(.rodata*) } :rodata
  .data.rel.ro : { *(.data.rel.ro*) } :rodata
  .dynamic : { *(.dynamic) } :dynamic
  .dynsym : { *(.dynsym) } :data
  .dynstr : { *(.dynstr) } :data
  .rel.dyn : { *(.rel.dyn) } :data
  /DISCARD/ : {
      *(.eh_frame*)
      *(.gnu.hash*)
      *(.hash*)
    }
}
